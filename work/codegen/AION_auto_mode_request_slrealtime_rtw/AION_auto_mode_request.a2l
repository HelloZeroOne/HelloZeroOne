/******************************************************************************
* ASAP2 file: AION_auto_mode_request.a2l
* Code generation for model "AION_auto_mode_request".
* Model version : 1.80
* Simulink Coder version : 10.3 R2021a
* C source code generated on : Sun May 22 17:48:12 2022
* Target selection: slrealtime.tlc
* Embedded hardware selection: Intel->x86-64 (Linux 64)
* Code generation objectives: Unspecified
* Validation result: Not run
* (add additional file header information here)
******************************************************************************/ ASAP2_VERSION 1 71
/begin PROJECT ProjectName "Project Comment Goes Here"
/begin HEADER "Header Comments go here" /end HEADER
/begin MODULE ModuleName "Module Comment Goes Here"
/begin IF_DATA XCP
 /begin PROTOCOL_LAYER 0x0100 0x03E8 0x00C8 0x0000 0x0000 0x0000 0x0000 0x0000 0xFC 0x0578 BYTE_ORDER_MSB_LAST ADDRESS_GRANULARITY_BYTE OPTIONAL_CMD ALLOC_ODT_ENTRY OPTIONAL_CMD ALLOC_ODT OPTIONAL_CMD ALLOC_DAQ OPTIONAL_CMD FREE_DAQ OPTIONAL_CMD GET_DAQ_RESOLUTION_INFO OPTIONAL_CMD GET_DAQ_PROCESSOR_INFO OPTIONAL_CMD START_STOP_SYNCH OPTIONAL_CMD START_STOP_DAQ_LIST OPTIONAL_CMD SET_DAQ_LIST_MODE OPTIONAL_CMD WRITE_DAQ OPTIONAL_CMD SET_DAQ_PTR OPTIONAL_CMD GET_CAL_PAGE OPTIONAL_CMD SET_CAL_PAGE OPTIONAL_CMD COPY_CAL_PAGE OPTIONAL_CMD SHORT_DOWNLOAD OPTIONAL_CMD DOWNLOAD_MAX OPTIONAL_CMD DOWNLOAD OPTIONAL_CMD SHORT_UPLOAD OPTIONAL_CMD UPLOAD OPTIONAL_CMD SET_MTA /end PROTOCOL_LAYER
 /begin DAQ DYNAMIC 0x0000 0x0080 0x00 OPTIMISATION_TYPE_DEFAULT ADDRESS_EXTENSION_FREE IDENTIFICATION_FIELD_TYPE_RELATIVE_WORD_ALIGNED GRANULARITY_ODT_ENTRY_SIZE_DAQ_BYTE 0xFF OVERLOAD_INDICATION_PID PRESCALER_SUPPORTED /begin STIM GRANULARITY_ODT_ENTRY_SIZE_STIM_BYTE 0xFF /end STIM /begin TIMESTAMP_SUPPORTED 0x0001 SIZE_DWORD UNIT_1US TIMESTAMP_FIXED /end TIMESTAMP_SUPPORTED /begin EVENT "200 ms" "200 ms" 0x0000 DAQ 0xFF 0x02 0x08 0x00 /end EVENT /end DAQ
 /begin XCP_ON_UDP_IP 0x0100 0x15B3 ADDRESS "192.168.7.1" /end XCP_ON_UDP_IP
/end IF_DATA
/begin MOD_PAR "MOD PAR Comment Goes Here" /end MOD_PAR
/begin MOD_COMMON "Mod Common Comment Here" BYTE_ORDER MSB_LAST ALIGNMENT_BYTE 1 ALIGNMENT_WORD 2 ALIGNMENT_LONG 8 ALIGNMENT_FLOAT32_IEEE 4 ALIGNMENT_FLOAT64_IEEE 8 ALIGNMENT_INT64 4 /end MOD_COMMON
/begin MEASUREMENT AION_auto_mode_request_B.ADCU_Checksum1 "" FLOAT64_IEEE AION_auto_mode_request_CM_double 0 0 -1.7E+308 1.7E+308 ECU_ADDRESS 0x002056D0 /end MEASUREMENT
/begin MEASUREMENT AION_auto_mode_request_B.ADCU_Checksum2 "" FLOAT64_IEEE AION_auto_mode_request_CM_double 0 0 -1.7E+308 1.7E+308 ECU_ADDRESS 0x002056E0 /end MEASUREMENT
/begin MEASUREMENT AION_auto_mode_request_B.ADCU_Checksum3 "" FLOAT64_IEEE AION_auto_mode_request_CM_double__ 0 0 -1.7E+308 1.7E+308 ECU_ADDRESS 0x002056F0 /end MEASUREMENT
/begin MEASUREMENT AION_auto_mode_request_B.ADCU_Msg1 "" FLOAT64_IEEE AION_auto_mode_request_CM_double 0 0 -1.7E+308 1.7E+308 ECU_ADDRESS 0x002056D8 /end MEASUREMENT
/begin MEASUREMENT AION_auto_mode_request_B.ADCU_Msg2 "" FLOAT64_IEEE AION_auto_mode_request_CM_double 0 0 -1.7E+308 1.7E+308 ECU_ADDRESS 0x002056E8 /end MEASUREMENT
/begin MEASUREMENT AION_auto_mode_request_B.ADCU_Msg3 "" FLOAT64_IEEE AION_auto_mode_request_CM_double__ 0 0 -1.7E+308 1.7E+308 ECU_ADDRESS 0x002056F8 /end MEASUREMENT
/begin MEASUREMENT AION_auto_mode_request_B.DataTypeConversion1 "" ULONG AION_auto_mode_request_CM_uint32 0 0 0 2147483646 ECU_ADDRESS 0x002057B8 /end MEASUREMENT
/begin MEASUREMENT AION_auto_mode_request_B.DataTypeConversion2 "" ULONG AION_auto_mode_request_CM_uint32 0 0 0 2147483646 ECU_ADDRESS 0x002057BC /end MEASUREMENT
/begin MEASUREMENT AION_auto_mode_request_B.DataTypeConversion3 "" ULONG AION_auto_mode_request_CM_uint32 0 0 0 2147483646 ECU_ADDRESS 0x002057C0 /end MEASUREMENT
/begin MEASUREMENT AION_auto_mode_request_B.DataTypeConversion4 "" ULONG AION_auto_mode_request_CM_uint32 0 0 0 2147483646 ECU_ADDRESS 0x002057C4 /end MEASUREMENT
/begin MEASUREMENT AION_auto_mode_request_B.DataTypeConversion5 "" ULONG AION_auto_mode_request_CM_uint32__ 0 0 0 2147483646 ECU_ADDRESS 0x002057C8 /end MEASUREMENT
/begin MEASUREMENT AION_auto_mode_request_B.DataTypeConversion6 "" ULONG AION_auto_mode_request_CM_uint32__ 0 0 0 2147483646 ECU_ADDRESS 0x002057CC /end MEASUREMENT
/begin MEASUREMENT AION_auto_mode_request_B.body_control_req "" SLONG AION_auto_mode_request_CM_Enable_request__ 0 0 0 1 ECU_ADDRESS 0x002057EC /end MEASUREMENT
/begin MEASUREMENT AION_auto_mode_request_B.get_ABSActiveSt "" UBYTE AION_auto_mode_request_CM_uint8__ 0 0 0 255 ECU_ADDRESS 0x00205837 /end MEASUREMENT
/begin MEASUREMENT AION_auto_mode_request_B.get_ABSFaultSt "" UBYTE AION_auto_mode_request_CM_uint8__ 0 0 0 255 ECU_ADDRESS 0x00205838 /end MEASUREMENT
/begin MEASUREMENT AION_auto_mode_request_B.get_ACCButtInfo "" ULONG AION_auto_mode_request_CM_uint32 0 0 0 2147483646 ECU_ADDRESS 0x00205798 /end MEASUREMENT
/begin MEASUREMENT AION_auto_mode_request_B.get_ACCMaxRecpDecel "" FLOAT64_IEEE AION_auto_mode_request_CM_double_m_s2 0 0 -1.7E+308 1.7E+308 ECU_ADDRESS 0x002056B8 /end MEASUREMENT
/begin MEASUREMENT AION_auto_mode_request_B.get_ACCMaxRecpDecelVD "" UBYTE AION_auto_mode_request_CM_uint8 0 0 0 255 ECU_ADDRESS 0x0020585F /end MEASUREMENT
/begin MEASUREMENT AION_auto_mode_request_B.get_AEBActive "" UBYTE AION_auto_mode_request_CM_uint8 0 0 0 255 ECU_ADDRESS 0x00205843 /end MEASUREMENT
/begin MEASUREMENT AION_auto_mode_request_B.get_AEBAvailable "" UBYTE AION_auto_mode_request_CM_uint8 0 0 0 255 ECU_ADDRESS 0x00205844 /end MEASUREMENT
/begin MEASUREMENT AION_auto_mode_request_B.get_AccElecECFail "" UBYTE AION_auto_mode_request_CM_uint8__ 0 0 0 255 ECU_ADDRESS 0x00205862 /end MEASUREMENT
/begin MEASUREMENT AION_auto_mode_request_B.get_ActRecpTorq "" ULONG AION_auto_mode_request_CM_uint32_Nm 0 0 0 2147483646 ECU_ADDRESS 0x00205790 /end MEASUREMENT
/begin MEASUREMENT AION_auto_mode_request_B.get_ActRecpTorqSt "" UBYTE AION_auto_mode_request_CM_uint8 0 0 0 255 ECU_ADDRESS 0x0020585C /end MEASUREMENT
/begin MEASUREMENT AION_auto_mode_request_B.get_ActVehLaltrlAccel "" FLOAT64_IEEE AION_auto_mode_request_CM_double_m_s_2 0 0 -1.7E+308 1.7E+308 ECU_ADDRESS 0x00205690 /end MEASUREMENT
/begin MEASUREMENT AION_auto_mode_request_B.get_ActVehLaltrlAccelVD "" UBYTE AION_auto_mode_request_CM_uint8 0 0 0 255 ECU_ADDRESS 0x00205858 /end MEASUREMENT
/begin MEASUREMENT AION_auto_mode_request_B.get_ActVehLongAccel "" FLOAT64_IEEE AION_auto_mode_request_CM_double_m_s_2 0 0 -1.7E+308 1.7E+308 ECU_ADDRESS 0x00205698 /end MEASUREMENT
/begin MEASUREMENT AION_auto_mode_request_B.get_ActVehLongAccelVD "" UBYTE AION_auto_mode_request_CM_uint8 0 0 0 255 ECU_ADDRESS 0x00205859 /end MEASUREMENT
/begin MEASUREMENT AION_auto_mode_request_B.get_ActVehWheelTorq "" ULONG AION_auto_mode_request_CM_uint32_Nm 0 0 0 2147483646 ECU_ADDRESS 0x00205794 /end MEASUREMENT
/begin MEASUREMENT AION_auto_mode_request_B.get_BrkPedalSt "" UBYTE AION_auto_mode_request_CM_uint8 0 0 0 255 ECU_ADDRESS 0x00205864 /end MEASUREMENT
/begin MEASUREMENT AION_auto_mode_request_B.get_BrkPedalStVD "" UBYTE AION_auto_mode_request_CM_uint8 0 0 0 255 ECU_ADDRESS 0x00205865 /end MEASUREMENT
/begin MEASUREMENT AION_auto_mode_request_B.get_CDDActive "" UBYTE AION_auto_mode_request_CM_uint8 0 0 0 255 ECU_ADDRESS 0x00205845 /end MEASUREMENT
/begin MEASUREMENT AION_auto_mode_request_B.get_CDDAvailable "" UBYTE AION_auto_mode_request_CM_uint8 0 0 0 255 ECU_ADDRESS 0x00205846 /end MEASUREMENT
/begin MEASUREMENT AION_auto_mode_request_B.get_CDDFail "" UBYTE AION_auto_mode_request_CM_uint8 0 0 0 255 ECU_ADDRESS 0x00205847 /end MEASUREMENT
/begin MEASUREMENT AION_auto_mode_request_B.get_Checksum1 "" ULONG AION_auto_mode_request_CM_uint32__ 0 0 0 2147483646 ECU_ADDRESS 0x002057A0 /end MEASUREMENT
/begin MEASUREMENT AION_auto_mode_request_B.get_Checksum10 "" ULONG AION_auto_mode_request_CM_uint32 0 0 0 2147483646 ECU_ADDRESS 0x002057A8 /end MEASUREMENT
/begin MEASUREMENT AION_auto_mode_request_B.get_Checksum11 "" ULONG AION_auto_mode_request_CM_uint32 0 0 0 2147483646 ECU_ADDRESS 0x002057B0 /end MEASUREMENT
/begin MEASUREMENT AION_auto_mode_request_B.get_Checksum12 "" ULONG AION_auto_mode_request_CM_uint32 0 0 0 2147483646 ECU_ADDRESS 0x00205700 /end MEASUREMENT
/begin MEASUREMENT AION_auto_mode_request_B.get_Checksum13 "" ULONG AION_auto_mode_request_CM_uint32 0 0 0 2147483646 ECU_ADDRESS 0x00205708 /end MEASUREMENT
/begin MEASUREMENT AION_auto_mode_request_B.get_Checksum16 "" ULONG AION_auto_mode_request_CM_uint32__ 0 0 0 2147483646 ECU_ADDRESS 0x00205720 /end MEASUREMENT
/begin MEASUREMENT AION_auto_mode_request_B.get_Checksum17 "" ULONG AION_auto_mode_request_CM_uint32__ 0 0 0 2147483646 ECU_ADDRESS 0x00205728 /end MEASUREMENT
/begin MEASUREMENT AION_auto_mode_request_B.get_Checksum18 "" ULONG AION_auto_mode_request_CM_uint32__ 0 0 0 2147483646 ECU_ADDRESS 0x00205730 /end MEASUREMENT
/begin MEASUREMENT AION_auto_mode_request_B.get_Checksum2 "" ULONG AION_auto_mode_request_CM_uint32 0 0 0 2147483646 ECU_ADDRESS 0x00205738 /end MEASUREMENT
/begin MEASUREMENT AION_auto_mode_request_B.get_Checksum3 "" ULONG AION_auto_mode_request_CM_uint32 0 0 0 2147483646 ECU_ADDRESS 0x00205740 /end MEASUREMENT
/begin MEASUREMENT AION_auto_mode_request_B.get_Checksum4 "" ULONG AION_auto_mode_request_CM_uint32__ 0 0 0 2147483646 ECU_ADDRESS 0x00205748 /end MEASUREMENT
/begin MEASUREMENT AION_auto_mode_request_B.get_Checksum5 "" ULONG AION_auto_mode_request_CM_uint32__ 0 0 0 2147483646 ECU_ADDRESS 0x00205750 /end MEASUREMENT
/begin MEASUREMENT AION_auto_mode_request_B.get_Checksum6 "" ULONG AION_auto_mode_request_CM_uint32 0 0 0 2147483646 ECU_ADDRESS 0x00205758 /end MEASUREMENT
/begin MEASUREMENT AION_auto_mode_request_B.get_Checksum7 "" ULONG AION_auto_mode_request_CM_uint32 0 0 0 2147483646 ECU_ADDRESS 0x00205760 /end MEASUREMENT
/begin MEASUREMENT AION_auto_mode_request_B.get_Checksum8 "" ULONG AION_auto_mode_request_CM_uint32 0 0 0 2147483646 ECU_ADDRESS 0x00205768 /end MEASUREMENT
/begin MEASUREMENT AION_auto_mode_request_B.get_Checksum9 "" ULONG AION_auto_mode_request_CM_uint32 0 0 0 2147483646 ECU_ADDRESS 0x00205770 /end MEASUREMENT
/begin MEASUREMENT AION_auto_mode_request_B.get_CrntGearLvl "" UBYTE AION_auto_mode_request_CM_uint8 0 0 0 255 ECU_ADDRESS 0x0020585D /end MEASUREMENT
/begin MEASUREMENT AION_auto_mode_request_B.get_CrntGearLvlVD "" UBYTE AION_auto_mode_request_CM_uint8 0 0 0 255 ECU_ADDRESS 0x0020585E /end MEASUREMENT
/begin MEASUREMENT AION_auto_mode_request_B.get_CtrlAvailable "" SLONG AION_auto_mode_request_CM_Available_status 0 0 0 1 ECU_ADDRESS 0x00205810 /end MEASUREMENT
/begin MEASUREMENT AION_auto_mode_request_B.get_DriverDoorAjarSt "" UBYTE AION_auto_mode_request_CM_uint8 0 0 0 255 ECU_ADDRESS 0x00205829 /end MEASUREMENT
/begin MEASUREMENT AION_auto_mode_request_B.get_DriverSeatBeltSt "" UBYTE AION_auto_mode_request_CM_uint8 0 0 0 255 ECU_ADDRESS 0x00205822 /end MEASUREMENT
/begin MEASUREMENT AION_auto_mode_request_B.get_EStopSwSt "" UBYTE AION_auto_mode_request_CM_uint8 0 0 0 255 ECU_ADDRESS 0x0020581C /end MEASUREMENT
/begin MEASUREMENT AION_auto_mode_request_B.get_EStopSwStVD "" UBYTE AION_auto_mode_request_CM_uint8 0 0 0 255 ECU_ADDRESS 0x0020581D /end MEASUREMENT
/begin MEASUREMENT AION_auto_mode_request_B.get_FLWheelRotatedDirection "" UBYTE AION_auto_mode_request_CM_uint8 0 0 0 255 ECU_ADDRESS 0x0020584C /end MEASUREMENT
/begin MEASUREMENT AION_auto_mode_request_B.get_FLWheelRotatedDirectionVD "" UBYTE AION_auto_mode_request_CM_uint8 0 0 0 255 ECU_ADDRESS 0x0020584D /end MEASUREMENT
/begin MEASUREMENT AION_auto_mode_request_B.get_FLWheelSpd "" FLOAT64_IEEE AION_auto_mode_request_CM_double_km_h 0 0 -1.7E+308 1.7E+308 ECU_ADDRESS 0x00205670 /end MEASUREMENT
/begin MEASUREMENT AION_auto_mode_request_B.get_FLWheelSpdEdgesSum "" ULONG AION_auto_mode_request_CM_uint32 0 0 0 2147483646 ECU_ADDRESS 0x0020577C /end MEASUREMENT
/begin MEASUREMENT AION_auto_mode_request_B.get_FLWheelSpdEdgesSumVD "" UBYTE AION_auto_mode_request_CM_uint8 0 0 0 255 ECU_ADDRESS 0x0020583C /end MEASUREMENT
/begin MEASUREMENT AION_auto_mode_request_B.get_FLWheelSpdVD "" UBYTE AION_auto_mode_request_CM_uint8 0 0 0 255 ECU_ADDRESS 0x0020584E /end MEASUREMENT
/begin MEASUREMENT AION_auto_mode_request_B.get_FRWheelRotatedDirection "" UBYTE AION_auto_mode_request_CM_uint8 0 0 0 255 ECU_ADDRESS 0x0020584F /end MEASUREMENT
/begin MEASUREMENT AION_auto_mode_request_B.get_FRWheelRotatedDirectionVD "" UBYTE AION_auto_mode_request_CM_uint8 0 0 0 255 ECU_ADDRESS 0x00205850 /end MEASUREMENT
/begin MEASUREMENT AION_auto_mode_request_B.get_FRWheelSpd "" FLOAT64_IEEE AION_auto_mode_request_CM_double_km_h 0 0 -1.7E+308 1.7E+308 ECU_ADDRESS 0x00205678 /end MEASUREMENT
/begin MEASUREMENT AION_auto_mode_request_B.get_FRWheelSpdEdgesSum "" ULONG AION_auto_mode_request_CM_uint32 0 0 0 2147483646 ECU_ADDRESS 0x00205780 /end MEASUREMENT
/begin MEASUREMENT AION_auto_mode_request_B.get_FRWheelSpdEdgesSumVD "" UBYTE AION_auto_mode_request_CM_uint8 0 0 0 255 ECU_ADDRESS 0x0020583D /end MEASUREMENT
/begin MEASUREMENT AION_auto_mode_request_B.get_FRWheelSpdVD "" UBYTE AION_auto_mode_request_CM_uint8 0 0 0 255 ECU_ADDRESS 0x00205851 /end MEASUREMENT
/begin MEASUREMENT AION_auto_mode_request_B.get_FailSt "" SLONG AION_auto_mode_request_CM_Error_status 0 0 0 1 ECU_ADDRESS 0x002057E8 /end MEASUREMENT
/begin MEASUREMENT AION_auto_mode_request_B.get_FrontFogLampSt "" UBYTE AION_auto_mode_request_CM_uint8 0 0 0 255 ECU_ADDRESS 0x0020582A /end MEASUREMENT
/begin MEASUREMENT AION_auto_mode_request_B.get_FrontWiperSt "" UBYTE AION_auto_mode_request_CM_uint8 0 0 0 255 ECU_ADDRESS 0x0020582B /end MEASUREMENT
/begin MEASUREMENT AION_auto_mode_request_B.get_GasPedalActPst "" FLOAT64_IEEE AION_auto_mode_request_CM_double__ 0 0 -1.7E+308 1.7E+308 ECU_ADDRESS 0x002056C0 /end MEASUREMENT
/begin MEASUREMENT AION_auto_mode_request_B.get_GasPedalActPstVD "" UBYTE AION_auto_mode_request_CM_uint8 0 0 0 255 ECU_ADDRESS 0x00205863 /end MEASUREMENT
/begin MEASUREMENT AION_auto_mode_request_B.get_GasPedalVirtualPst "" FLOAT64_IEEE AION_auto_mode_request_CM_double__ 0 0 -1.7E+308 1.7E+308 ECU_ADDRESS 0x002056C8 /end MEASUREMENT
/begin MEASUREMENT AION_auto_mode_request_B.get_GasPedalVirtualPstVD "" UBYTE AION_auto_mode_request_CM_uint8 0 0 0 255 ECU_ADDRESS 0x00205866 /end MEASUREMENT
/begin MEASUREMENT AION_auto_mode_request_B.get_GearLeverIntv "" UBYTE AION_auto_mode_request_CM_uint8 0 0 0 255 ECU_ADDRESS 0x0020585A /end MEASUREMENT
/begin MEASUREMENT AION_auto_mode_request_B.get_HDCCtrlSt "" UBYTE AION_auto_mode_request_CM_uint8__ 0 0 0 255 ECU_ADDRESS 0x00205841 /end MEASUREMENT
/begin MEASUREMENT AION_auto_mode_request_B.get_HDCErrSt "" UBYTE AION_auto_mode_request_CM_uint8__ 0 0 0 255 ECU_ADDRESS 0x00205842 /end MEASUREMENT
/begin MEASUREMENT AION_auto_mode_request_B.get_HazardLampSt "" UBYTE AION_auto_mode_request_CM_uint8 0 0 0 255 ECU_ADDRESS 0x0020582C /end MEASUREMENT
/begin MEASUREMENT AION_auto_mode_request_B.get_HighBeamSt "" UBYTE AION_auto_mode_request_CM_uint8 0 0 0 255 ECU_ADDRESS 0x0020582D /end MEASUREMENT
/begin MEASUREMENT AION_auto_mode_request_B.get_HornSt "" UBYTE AION_auto_mode_request_CM_uint8 0 0 0 255 ECU_ADDRESS 0x0020582E /end MEASUREMENT
/begin MEASUREMENT AION_auto_mode_request_B.get_KeySt "" UBYTE AION_auto_mode_request_CM_uint8 0 0 0 255 ECU_ADDRESS 0x0020582F /end MEASUREMENT
/begin MEASUREMENT AION_auto_mode_request_B.get_LatAutoCheckReport "" ULONG AION_auto_mode_request_CM_uint32 0 0 0 2147483646 ECU_ADDRESS 0x00205710 /end MEASUREMENT
/begin MEASUREMENT AION_auto_mode_request_B.get_LatCtrlMode "" SLONG AION_auto_mode_request_CM_Control_status 0 0 0 3 ECU_ADDRESS 0x002057F0 /end MEASUREMENT
/begin MEASUREMENT AION_auto_mode_request_B.get_LatQuitReport "" ULONG AION_auto_mode_request_CM_uint32 0 0 0 2147483646 ECU_ADDRESS 0x00205714 /end MEASUREMENT
/begin MEASUREMENT AION_auto_mode_request_B.get_LateralAssistBtnInfo "" UBYTE AION_auto_mode_request_CM_uint8 0 0 0 255 ECU_ADDRESS 0x00205860 /end MEASUREMENT
/begin MEASUREMENT AION_auto_mode_request_B.get_LateralAssistBtnInfoVD "" UBYTE AION_auto_mode_request_CM_uint8 0 0 0 255 ECU_ADDRESS 0x00205861 /end MEASUREMENT
/begin MEASUREMENT AION_auto_mode_request_B.get_LeftTurnLampFaultSt "" SLONG AION_auto_mode_request_CM_Fault_status 0 0 0 1 ECU_ADDRESS 0x002057E0 /end MEASUREMENT
/begin MEASUREMENT AION_auto_mode_request_B.get_LeftTurnLampSt "" UBYTE AION_auto_mode_request_CM_uint8 0 0 0 255 ECU_ADDRESS 0x00205830 /end MEASUREMENT
/begin MEASUREMENT AION_auto_mode_request_B.get_LngAutoCheckIReport "" ULONG AION_auto_mode_request_CM_uint32 0 0 0 2147483646 ECU_ADDRESS 0x00205718 /end MEASUREMENT
/begin MEASUREMENT AION_auto_mode_request_B.get_LngCtrlMode "" SLONG AION_auto_mode_request_CM_Control_status 0 0 0 3 ECU_ADDRESS 0x002057F4 /end MEASUREMENT
/begin MEASUREMENT AION_auto_mode_request_B.get_LngQuitReport "" ULONG AION_auto_mode_request_CM_uint32 0 0 0 2147483646 ECU_ADDRESS 0x0020571C /end MEASUREMENT
/begin MEASUREMENT AION_auto_mode_request_B.get_LowBeamSt "" UBYTE AION_auto_mode_request_CM_uint8 0 0 0 255 ECU_ADDRESS 0x00205831 /end MEASUREMENT
/begin MEASUREMENT AION_auto_mode_request_B.get_MasterCylinderPr "" FLOAT64_IEEE AION_auto_mode_request_CM_double_bar 0 0 -1.7E+308 1.7E+308 ECU_ADDRESS 0x00205660 /end MEASUREMENT
/begin MEASUREMENT AION_auto_mode_request_B.get_MasterCylinderPrOffset "" FLOAT64_IEEE AION_auto_mode_request_CM_double_bar 0 0 -1.7E+308 1.7E+308 ECU_ADDRESS 0x00205668 /end MEASUREMENT
/begin MEASUREMENT AION_auto_mode_request_B.get_MasterCylinderPrOffsetVD "" UBYTE AION_auto_mode_request_CM_uint8__ 0 0 0 255 ECU_ADDRESS 0x00205848 /end MEASUREMENT
/begin MEASUREMENT AION_auto_mode_request_B.get_MasterCylinderPrVD "" UBYTE AION_auto_mode_request_CM_uint8__ 0 0 0 255 ECU_ADDRESS 0x00205849 /end MEASUREMENT
/begin MEASUREMENT AION_auto_mode_request_B.get_MsgCounter1 "" ULONG AION_auto_mode_request_CM_uint32__ 0 0 0 2147483646 ECU_ADDRESS 0x002057A4 /end MEASUREMENT
/begin MEASUREMENT AION_auto_mode_request_B.get_MsgCounter10 "" ULONG AION_auto_mode_request_CM_uint32 0 0 0 2147483646 ECU_ADDRESS 0x002057AC /end MEASUREMENT
/begin MEASUREMENT AION_auto_mode_request_B.get_MsgCounter11 "" ULONG AION_auto_mode_request_CM_uint32 0 0 0 2147483646 ECU_ADDRESS 0x002057B4 /end MEASUREMENT
/begin MEASUREMENT AION_auto_mode_request_B.get_MsgCounter12 "" ULONG AION_auto_mode_request_CM_uint32 0 0 0 2147483646 ECU_ADDRESS 0x00205704 /end MEASUREMENT
/begin MEASUREMENT AION_auto_mode_request_B.get_MsgCounter13 "" ULONG AION_auto_mode_request_CM_uint32 0 0 0 2147483646 ECU_ADDRESS 0x0020570C /end MEASUREMENT
/begin MEASUREMENT AION_auto_mode_request_B.get_MsgCounter16 "" ULONG AION_auto_mode_request_CM_uint32__ 0 0 0 2147483646 ECU_ADDRESS 0x00205724 /end MEASUREMENT
/begin MEASUREMENT AION_auto_mode_request_B.get_MsgCounter17 "" ULONG AION_auto_mode_request_CM_uint32__ 0 0 0 2147483646 ECU_ADDRESS 0x0020572C /end MEASUREMENT
/begin MEASUREMENT AION_auto_mode_request_B.get_MsgCounter18 "" ULONG AION_auto_mode_request_CM_uint32__ 0 0 0 2147483646 ECU_ADDRESS 0x00205734 /end MEASUREMENT
/begin MEASUREMENT AION_auto_mode_request_B.get_MsgCounter2 "" ULONG AION_auto_mode_request_CM_uint32 0 0 0 2147483646 ECU_ADDRESS 0x0020573C /end MEASUREMENT
/begin MEASUREMENT AION_auto_mode_request_B.get_MsgCounter3 "" ULONG AION_auto_mode_request_CM_uint32 0 0 0 2147483646 ECU_ADDRESS 0x00205744 /end MEASUREMENT
/begin MEASUREMENT AION_auto_mode_request_B.get_MsgCounter4 "" ULONG AION_auto_mode_request_CM_uint32__ 0 0 0 2147483646 ECU_ADDRESS 0x0020574C /end MEASUREMENT
/begin MEASUREMENT AION_auto_mode_request_B.get_MsgCounter5 "" ULONG AION_auto_mode_request_CM_uint32 0 0 0 2147483646 ECU_ADDRESS 0x00205754 /end MEASUREMENT
/begin MEASUREMENT AION_auto_mode_request_B.get_MsgCounter6 "" ULONG AION_auto_mode_request_CM_uint32 0 0 0 2147483646 ECU_ADDRESS 0x0020575C /end MEASUREMENT
/begin MEASUREMENT AION_auto_mode_request_B.get_MsgCounter7 "" ULONG AION_auto_mode_request_CM_uint32 0 0 0 2147483646 ECU_ADDRESS 0x00205764 /end MEASUREMENT
/begin MEASUREMENT AION_auto_mode_request_B.get_MsgCounter8 "" ULONG AION_auto_mode_request_CM_uint32 0 0 0 2147483646 ECU_ADDRESS 0x0020576C /end MEASUREMENT
/begin MEASUREMENT AION_auto_mode_request_B.get_MsgCounter9 "" ULONG AION_auto_mode_request_CM_uint32 0 0 0 2147483646 ECU_ADDRESS 0x00205774 /end MEASUREMENT
/begin MEASUREMENT AION_auto_mode_request_B.get_NoBrakeForce "" UBYTE AION_auto_mode_request_CM_uint8 0 0 0 255 ECU_ADDRESS 0x0020584A /end MEASUREMENT
/begin MEASUREMENT AION_auto_mode_request_B.get_PsngrDoorAjarSt "" UBYTE AION_auto_mode_request_CM_uint8 0 0 0 255 ECU_ADDRESS 0x00205832 /end MEASUREMENT
/begin MEASUREMENT AION_auto_mode_request_B.get_PsngrSeatBeltSt "" UBYTE AION_auto_mode_request_CM_uint8 0 0 0 255 ECU_ADDRESS 0x00205823 /end MEASUREMENT
/begin MEASUREMENT AION_auto_mode_request_B.get_RLDoorAjarSt "" UBYTE AION_auto_mode_request_CM_uint8 0 0 0 255 ECU_ADDRESS 0x00205833 /end MEASUREMENT
/begin MEASUREMENT AION_auto_mode_request_B.get_RLWheelRotatedDirection "" UBYTE AION_auto_mode_request_CM_uint8 0 0 0 255 ECU_ADDRESS 0x00205852 /end MEASUREMENT
/begin MEASUREMENT AION_auto_mode_request_B.get_RLWheelRotatedDirectionVD "" UBYTE AION_auto_mode_request_CM_uint8 0 0 0 255 ECU_ADDRESS 0x00205853 /end MEASUREMENT
/begin MEASUREMENT AION_auto_mode_request_B.get_RLWheelSpd "" FLOAT64_IEEE AION_auto_mode_request_CM_double_km_h 0 0 -1.7E+308 1.7E+308 ECU_ADDRESS 0x00205680 /end MEASUREMENT
/begin MEASUREMENT AION_auto_mode_request_B.get_RLWheelSpdEdgesSum "" ULONG AION_auto_mode_request_CM_uint32 0 0 0 2147483646 ECU_ADDRESS 0x00205784 /end MEASUREMENT
/begin MEASUREMENT AION_auto_mode_request_B.get_RLWheelSpdEdgesSumVD "" UBYTE AION_auto_mode_request_CM_uint8 0 0 0 255 ECU_ADDRESS 0x0020583E /end MEASUREMENT
/begin MEASUREMENT AION_auto_mode_request_B.get_RLWheelSpdVD "" UBYTE AION_auto_mode_request_CM_uint8 0 0 0 255 ECU_ADDRESS 0x00205854 /end MEASUREMENT
/begin MEASUREMENT AION_auto_mode_request_B.get_RRDoorAjarSt "" UBYTE AION_auto_mode_request_CM_uint8 0 0 0 255 ECU_ADDRESS 0x00205834 /end MEASUREMENT
/begin MEASUREMENT AION_auto_mode_request_B.get_RRWheelRotatedDirection "" UBYTE AION_auto_mode_request_CM_uint8 0 0 0 255 ECU_ADDRESS 0x00205855 /end MEASUREMENT
/begin MEASUREMENT AION_auto_mode_request_B.get_RRWheelRotatedDirectionVD "" UBYTE AION_auto_mode_request_CM_uint8 0 0 0 255 ECU_ADDRESS 0x00205856 /end MEASUREMENT
/begin MEASUREMENT AION_auto_mode_request_B.get_RRWheelSpd "" FLOAT64_IEEE AION_auto_mode_request_CM_double_km_h 0 0 -1.7E+308 1.7E+308 ECU_ADDRESS 0x00205688 /end MEASUREMENT
/begin MEASUREMENT AION_auto_mode_request_B.get_RRWheelSpdEdgesSum "" ULONG AION_auto_mode_request_CM_uint32 0 0 0 2147483646 ECU_ADDRESS 0x00205788 /end MEASUREMENT
/begin MEASUREMENT AION_auto_mode_request_B.get_RRWheelSpdEdgesSumVD "" UBYTE AION_auto_mode_request_CM_uint8 0 0 0 255 ECU_ADDRESS 0x0020583F /end MEASUREMENT
/begin MEASUREMENT AION_auto_mode_request_B.get_RRWheelSpdVD "" UBYTE AION_auto_mode_request_CM_uint8 0 0 0 255 ECU_ADDRESS 0x00205857 /end MEASUREMENT
/begin MEASUREMENT AION_auto_mode_request_B.get_RearFogLampSt "" UBYTE AION_auto_mode_request_CM_uint8 0 0 0 255 ECU_ADDRESS 0x00205835 /end MEASUREMENT
/begin MEASUREMENT AION_auto_mode_request_B.get_RightTurnLampFaultSt "" SLONG AION_auto_mode_request_CM_Fault_status 0 0 0 1 ECU_ADDRESS 0x002057E4 /end MEASUREMENT
/begin MEASUREMENT AION_auto_mode_request_B.get_RightTurnLampSt "" UBYTE AION_auto_mode_request_CM_uint8 0 0 0 255 ECU_ADDRESS 0x00205836 /end MEASUREMENT
/begin MEASUREMENT AION_auto_mode_request_B.get_SteeringAngle "" FLOAT64_IEEE AION_auto_mode_request_CM_double_deg 0 0 -1.7E+308 1.7E+308 ECU_ADDRESS 0x00205620 /end MEASUREMENT
/begin MEASUREMENT AION_auto_mode_request_B.get_SteeringAngleSpd "" ULONG AION_auto_mode_request_CM_uint32_deg_sec 0 0 0 2147483646 ECU_ADDRESS 0x00205778 /end MEASUREMENT
/begin MEASUREMENT AION_auto_mode_request_B.get_SteeringAngleSpdVD "" UBYTE AION_auto_mode_request_CM_uint8 0 0 0 255 ECU_ADDRESS 0x00205824 /end MEASUREMENT
/begin MEASUREMENT AION_auto_mode_request_B.get_SteeringAngleVD "" UBYTE AION_auto_mode_request_CM_uint8 0 0 0 255 ECU_ADDRESS 0x00205825 /end MEASUREMENT
/begin MEASUREMENT AION_auto_mode_request_B.get_StrngWhlIntv "" UBYTE AION_auto_mode_request_CM_uint8 0 0 0 255 ECU_ADDRESS 0x0020581E /end MEASUREMENT
/begin MEASUREMENT AION_auto_mode_request_B.get_StrngWhlTorq "" FLOAT64_IEEE AION_auto_mode_request_CM_double_Nm 0 0 -1.7E+308 1.7E+308 ECU_ADDRESS 0x00205628 /end MEASUREMENT
/begin MEASUREMENT AION_auto_mode_request_B.get_StrngWhlTorqVD "" UBYTE AION_auto_mode_request_CM_uint8 0 0 0 255 ECU_ADDRESS 0x00205826 /end MEASUREMENT
/begin MEASUREMENT AION_auto_mode_request_B.get_SwitchSt "" UBYTE AION_auto_mode_request_CM_uint8 0 0 0 255 ECU_ADDRESS 0x0020581F /end MEASUREMENT
/begin MEASUREMENT AION_auto_mode_request_B.get_SwitchStVD "" UBYTE AION_auto_mode_request_CM_uint8 0 0 0 255 ECU_ADDRESS 0x00205820 /end MEASUREMENT
/begin MEASUREMENT AION_auto_mode_request_B.get_SysSt "" UBYTE AION_auto_mode_request_CM_uint8 0 0 0 255 ECU_ADDRESS 0x00205821 /end MEASUREMENT
/begin MEASUREMENT AION_auto_mode_request_B.get_ThermalSt "" UBYTE AION_auto_mode_request_CM_uint8 0 0 0 255 ECU_ADDRESS 0x00205827 /end MEASUREMENT
/begin MEASUREMENT AION_auto_mode_request_B.get_VDCActiveSt "" UBYTE AION_auto_mode_request_CM_uint8__ 0 0 0 255 ECU_ADDRESS 0x00205839 /end MEASUREMENT
/begin MEASUREMENT AION_auto_mode_request_B.get_VDCFaultSt "" UBYTE AION_auto_mode_request_CM_uint8__ 0 0 0 255 ECU_ADDRESS 0x0020583A /end MEASUREMENT
/begin MEASUREMENT AION_auto_mode_request_B.get_VehDrvMod "" UBYTE AION_auto_mode_request_CM_uint8__ 0 0 0 255 ECU_ADDRESS 0x0020585B /end MEASUREMENT
/begin MEASUREMENT AION_auto_mode_request_B.get_VehLaltrlAccelOffset "" FLOAT64_IEEE AION_auto_mode_request_CM_double_m_s_2 0 0 -1.7E+308 1.7E+308 ECU_ADDRESS 0x002056A8 /end MEASUREMENT
/begin MEASUREMENT AION_auto_mode_request_B.get_VehLongAccelOffset "" FLOAT64_IEEE AION_auto_mode_request_CM_double_m_s_2 0 0 -1.7E+308 1.7E+308 ECU_ADDRESS 0x002056B0 /end MEASUREMENT
/begin MEASUREMENT AION_auto_mode_request_B.get_VehRdySt "" SLONG AION_auto_mode_request_CM_Ready_status__ 0 0 0 1 ECU_ADDRESS 0x002057D8 /end MEASUREMENT
/begin MEASUREMENT AION_auto_mode_request_B.get_VehRng "" ULONG AION_auto_mode_request_CM_uint32_km 0 0 0 2147483646 ECU_ADDRESS 0x0020578C /end MEASUREMENT
/begin MEASUREMENT AION_auto_mode_request_B.get_VehSpd "" FLOAT64_IEEE AION_auto_mode_request_CM_double_km_h 0 0 -1.7E+308 1.7E+308 ECU_ADDRESS 0x00205638 /end MEASUREMENT
/begin MEASUREMENT AION_auto_mode_request_B.get_VehSpdVD "" UBYTE AION_auto_mode_request_CM_uint8__ 0 0 0 255 ECU_ADDRESS 0x0020583B /end MEASUREMENT
/begin MEASUREMENT AION_auto_mode_request_B.get_VehWheelTorqMax "" ULONG AION_auto_mode_request_CM_uint32_Nm 0 0 0 2147483646 ECU_ADDRESS 0x0020579C /end MEASUREMENT
/begin MEASUREMENT AION_auto_mode_request_B.get_VehicleStandStillSt "" UBYTE AION_auto_mode_request_CM_uint8 0 0 0 255 ECU_ADDRESS 0x0020584B /end MEASUREMENT
/begin MEASUREMENT AION_auto_mode_request_B.get_WarnLamp "" UBYTE AION_auto_mode_request_CM_uint8 0 0 0 255 ECU_ADDRESS 0x00205828 /end MEASUREMENT
/begin MEASUREMENT AION_auto_mode_request_B.get_YawRate "" FLOAT64_IEEE AION_auto_mode_request_CM_double_rad_s 0 0 -1.7E+308 1.7E+308 ECU_ADDRESS 0x00205648 /end MEASUREMENT
/begin MEASUREMENT AION_auto_mode_request_B.get_YawRateOffset "" FLOAT64_IEEE AION_auto_mode_request_CM_double_rad_s 0 0 -1.7E+308 1.7E+308 ECU_ADDRESS 0x00205650 /end MEASUREMENT
/begin MEASUREMENT AION_auto_mode_request_B.get_YawRateSt "" UBYTE AION_auto_mode_request_CM_uint8 0 0 0 255 ECU_ADDRESS 0x00205840 /end MEASUREMENT
/begin MEASUREMENT AION_auto_mode_request_B.lateral_control_req "" SLONG AION_auto_mode_request_CM_Control_request 0 0 0 3 ECU_ADDRESS 0x00205808 /end MEASUREMENT
/begin MEASUREMENT AION_auto_mode_request_B.lateral_control_req_test "" SLONG AION_auto_mode_request_CM_Control_request 0 0 0 3 ECU_ADDRESS 0x00205804 /end MEASUREMENT
/begin MEASUREMENT AION_auto_mode_request_B.longitudinal_control_req "" SLONG AION_auto_mode_request_CM_Control_request 0 0 0 3 ECU_ADDRESS 0x00205800 /end MEASUREMENT
/begin MEASUREMENT AION_auto_mode_request_B.set_AutoTrqWhlReq "" SLONG AION_auto_mode_request_CM_int32 0 0 -2147483648 2147483647 ECU_ADDRESS 0x002057D0 /end MEASUREMENT
/begin MEASUREMENT AION_auto_mode_request_B.set_BeamReq "" SLONG AION_auto_mode_request_CM_Beam_request__ 0 0 0 3 ECU_ADDRESS 0x0020580C /end MEASUREMENT
/begin MEASUREMENT AION_auto_mode_request_B.set_BrakeReq "" FLOAT64_IEEE AION_auto_mode_request_CM_double 0 0 -1.7E+308 1.7E+308 ECU_ADDRESS 0x002056A0 /end MEASUREMENT
/begin MEASUREMENT AION_auto_mode_request_B.set_GearLvlReq "" SLONG AION_auto_mode_request_CM_AION_gear 0 0 0 7 ECU_ADDRESS 0x00205818 /end MEASUREMENT
/begin MEASUREMENT AION_auto_mode_request_B.set_GearLvlReqVD "" SLONG AION_auto_mode_request_CM_Validation_status 0 0 0 1 ECU_ADDRESS 0x002057D4 /end MEASUREMENT
/begin MEASUREMENT AION_auto_mode_request_B.set_HornRingReq "" SLONG AION_auto_mode_request_CM_Active_request__ 0 0 0 1 ECU_ADDRESS 0x00205814 /end MEASUREMENT
/begin MEASUREMENT AION_auto_mode_request_B.set_SteerAngReq "" FLOAT64_IEEE AION_auto_mode_request_CM_double 0 0 -1.7E+308 1.7E+308 ECU_ADDRESS 0x00205640 /end MEASUREMENT
/begin MEASUREMENT AION_auto_mode_request_B.set_SteerAngSpdLimt "" FLOAT64_IEEE AION_auto_mode_request_CM_double 0 0 -1.7E+308 1.7E+308 ECU_ADDRESS 0x00205658 /end MEASUREMENT
/begin MEASUREMENT AION_auto_mode_request_B.set_SteerWhlTorqReq "" FLOAT64_IEEE AION_auto_mode_request_CM_double 0 0 -1.7E+308 1.7E+308 ECU_ADDRESS 0x00205630 /end MEASUREMENT
/begin MEASUREMENT AION_auto_mode_request_B.set_TurnLightReq "" SLONG AION_auto_mode_request_CM_Light_request__ 0 0 0 3 ECU_ADDRESS 0x002057DC /end MEASUREMENT
/begin MEASUREMENT AION_auto_mode_request_B.y "" SLONG AION_auto_mode_request_CM_Control_status 0 0 0 3 ECU_ADDRESS 0x002057F8 /end MEASUREMENT
/begin MEASUREMENT AION_auto_mode_request_B.y_f "" SLONG AION_auto_mode_request_CM_Control_status 0 0 0 3 ECU_ADDRESS 0x002057FC /end MEASUREMENT
/begin MEASUREMENT AION_auto_mode_request_DW.adcu_msg_count "" FLOAT64_IEEE AION_auto_mode_request_CM_double 0 0 -1.7E+308 1.7E+308 ECU_ADDRESS 0x002055C0 /end MEASUREMENT
/begin MEASUREMENT AION_auto_mode_request_U.control_available_get_BCM_info_get_CtrlAvailable "" SLONG AION_auto_mode_request_CM_Available_status 0 0 0 1 ECU_ADDRESS 0x0020559C /end MEASUREMENT
/begin MEASUREMENT AION_auto_mode_request_U.control_available_get_BCM_info_get_DriverDoorAjarSt "" UBYTE AION_auto_mode_request_CM_uint8 0 0 0 1 ECU_ADDRESS 0x002055A0 /end MEASUREMENT
/begin MEASUREMENT AION_auto_mode_request_U.control_available_get_BCM_info_get_FrontFogLampSt "" UBYTE AION_auto_mode_request_CM_uint8 0 0 0 1 ECU_ADDRESS 0x002055A1 /end MEASUREMENT
/begin MEASUREMENT AION_auto_mode_request_U.control_available_get_BCM_info_get_FrontWiperSt "" UBYTE AION_auto_mode_request_CM_uint8 0 0 0 3 ECU_ADDRESS 0x002055A2 /end MEASUREMENT
/begin MEASUREMENT AION_auto_mode_request_U.control_available_get_BCM_info_get_HazardLampSt "" UBYTE AION_auto_mode_request_CM_uint8 0 0 0 1 ECU_ADDRESS 0x002055A3 /end MEASUREMENT
/begin MEASUREMENT AION_auto_mode_request_U.control_available_get_BCM_info_get_HighBeamSt "" UBYTE AION_auto_mode_request_CM_uint8 0 0 0 1 ECU_ADDRESS 0x002055A4 /end MEASUREMENT
/begin MEASUREMENT AION_auto_mode_request_U.control_available_get_BCM_info_get_HornSt "" UBYTE AION_auto_mode_request_CM_uint8 0 0 0 1 ECU_ADDRESS 0x002055A5 /end MEASUREMENT
/begin MEASUREMENT AION_auto_mode_request_U.control_available_get_BCM_info_get_KeySt "" UBYTE AION_auto_mode_request_CM_uint8 0 0 0 3 ECU_ADDRESS 0x002055A6 /end MEASUREMENT
/begin MEASUREMENT AION_auto_mode_request_U.control_available_get_BCM_info_get_LeftTurnLampFaultSt "" SLONG AION_auto_mode_request_CM_Fault_status 0 0 0 1 ECU_ADDRESS 0x002055A8 /end MEASUREMENT
/begin MEASUREMENT AION_auto_mode_request_U.control_available_get_BCM_info_get_LeftTurnLampSt "" UBYTE AION_auto_mode_request_CM_uint8 0 0 0 1 ECU_ADDRESS 0x002055AC /end MEASUREMENT
/begin MEASUREMENT AION_auto_mode_request_U.control_available_get_BCM_info_get_LowBeamSt "" UBYTE AION_auto_mode_request_CM_uint8 0 0 0 1 ECU_ADDRESS 0x002055AD /end MEASUREMENT
/begin MEASUREMENT AION_auto_mode_request_U.control_available_get_BCM_info_get_PsngrDoorAjarSt "" UBYTE AION_auto_mode_request_CM_uint8 0 0 0 1 ECU_ADDRESS 0x002055AE /end MEASUREMENT
/begin MEASUREMENT AION_auto_mode_request_U.control_available_get_BCM_info_get_RLDoorAjarSt "" UBYTE AION_auto_mode_request_CM_uint8 0 0 0 1 ECU_ADDRESS 0x002055AF /end MEASUREMENT
/begin MEASUREMENT AION_auto_mode_request_U.control_available_get_BCM_info_get_RRDoorAjarSt "" UBYTE AION_auto_mode_request_CM_uint8 0 0 0 1 ECU_ADDRESS 0x002055B0 /end MEASUREMENT
/begin MEASUREMENT AION_auto_mode_request_U.control_available_get_BCM_info_get_RearFogLampSt "" UBYTE AION_auto_mode_request_CM_uint8 0 0 0 1 ECU_ADDRESS 0x002055B1 /end MEASUREMENT
/begin MEASUREMENT AION_auto_mode_request_U.control_available_get_BCM_info_get_RightTurnLampFaultSt "" SLONG AION_auto_mode_request_CM_Fault_status 0 0 0 1 ECU_ADDRESS 0x002055B4 /end MEASUREMENT
/begin MEASUREMENT AION_auto_mode_request_U.control_available_get_BCM_info_get_RightTurnLampSt "" UBYTE AION_auto_mode_request_CM_uint8 0 0 0 1 ECU_ADDRESS 0x002055B8 /end MEASUREMENT
/begin MEASUREMENT AION_auto_mode_request_U.control_available_get_BCS_info_get_ABSActiveSt "" UBYTE AION_auto_mode_request_CM_uint8__ 0 0 0 1 ECU_ADDRESS 0x002053A0 /end MEASUREMENT
/begin MEASUREMENT AION_auto_mode_request_U.control_available_get_BCS_info_get_ABSFaultSt "" UBYTE AION_auto_mode_request_CM_uint8__ 0 0 0 1 ECU_ADDRESS 0x002053A1 /end MEASUREMENT
/begin MEASUREMENT AION_auto_mode_request_U.control_available_get_BCS_info_get_AEBActive "" UBYTE AION_auto_mode_request_CM_uint8 0 0 0 1 ECU_ADDRESS 0x002053EB /end MEASUREMENT
/begin MEASUREMENT AION_auto_mode_request_U.control_available_get_BCS_info_get_AEBAvailable "" UBYTE AION_auto_mode_request_CM_uint8 0 0 0 1 ECU_ADDRESS 0x002053EC /end MEASUREMENT
/begin MEASUREMENT AION_auto_mode_request_U.control_available_get_BCS_info_get_ActVehLaltrlAccel "" FLOAT64_IEEE AION_auto_mode_request_CM_double_m_s_2 0 0 -21.593 21.593 ECU_ADDRESS 0x00205448 /end MEASUREMENT
/begin MEASUREMENT AION_auto_mode_request_U.control_available_get_BCS_info_get_ActVehLaltrlAccelVD "" UBYTE AION_auto_mode_request_CM_uint8 0 0 0 1 ECU_ADDRESS 0x00205450 /end MEASUREMENT
/begin MEASUREMENT AION_auto_mode_request_U.control_available_get_BCS_info_get_ActVehLongAccel "" FLOAT64_IEEE AION_auto_mode_request_CM_double_m_s_2 0 0 -21.593 21.593 ECU_ADDRESS 0x00205458 /end MEASUREMENT
/begin MEASUREMENT AION_auto_mode_request_U.control_available_get_BCS_info_get_ActVehLongAccelVD "" UBYTE AION_auto_mode_request_CM_uint8 0 0 0 1 ECU_ADDRESS 0x00205460 /end MEASUREMENT
/begin MEASUREMENT AION_auto_mode_request_U.control_available_get_BCS_info_get_CDDActive "" UBYTE AION_auto_mode_request_CM_uint8 0 0 0 1 ECU_ADDRESS 0x002053ED /end MEASUREMENT
/begin MEASUREMENT AION_auto_mode_request_U.control_available_get_BCS_info_get_CDDAvailable "" UBYTE AION_auto_mode_request_CM_uint8 0 0 0 1 ECU_ADDRESS 0x002053EE /end MEASUREMENT
/begin MEASUREMENT AION_auto_mode_request_U.control_available_get_BCS_info_get_CDDFail "" UBYTE AION_auto_mode_request_CM_uint8 0 0 0 1 ECU_ADDRESS 0x002053EF /end MEASUREMENT
/begin MEASUREMENT AION_auto_mode_request_U.control_available_get_BCS_info_get_FLWheelRotatedDirection "" UBYTE AION_auto_mode_request_CM_uint8 0 0 0 1 ECU_ADDRESS 0x00205404 /end MEASUREMENT
/begin MEASUREMENT AION_auto_mode_request_U.control_available_get_BCS_info_get_FLWheelRotatedDirectionVD "" UBYTE AION_auto_mode_request_CM_uint8 0 0 0 1 ECU_ADDRESS 0x00205405 /end MEASUREMENT
/begin MEASUREMENT AION_auto_mode_request_U.control_available_get_BCS_info_get_FLWheelSpd "" FLOAT64_IEEE AION_auto_mode_request_CM_double_km_h 0 0 0 240 ECU_ADDRESS 0x00205408 /end MEASUREMENT
/begin MEASUREMENT AION_auto_mode_request_U.control_available_get_BCS_info_get_FLWheelSpdEdgesSum "" ULONG AION_auto_mode_request_CM_uint32 0 0 0 4095 ECU_ADDRESS 0x002053B4 /end MEASUREMENT
/begin MEASUREMENT AION_auto_mode_request_U.control_available_get_BCS_info_get_FLWheelSpdEdgesSumVD "" UBYTE AION_auto_mode_request_CM_uint8 0 0 0 1 ECU_ADDRESS 0x002053B8 /end MEASUREMENT
/begin MEASUREMENT AION_auto_mode_request_U.control_available_get_BCS_info_get_FLWheelSpdVD "" UBYTE AION_auto_mode_request_CM_uint8 0 0 0 1 ECU_ADDRESS 0x00205410 /end MEASUREMENT
/begin MEASUREMENT AION_auto_mode_request_U.control_available_get_BCS_info_get_FRWheelRotatedDirection "" UBYTE AION_auto_mode_request_CM_uint8 0 0 0 1 ECU_ADDRESS 0x00205411 /end MEASUREMENT
/begin MEASUREMENT AION_auto_mode_request_U.control_available_get_BCS_info_get_FRWheelRotatedDirectionVD "" UBYTE AION_auto_mode_request_CM_uint8 0 0 0 1 ECU_ADDRESS 0x00205412 /end MEASUREMENT
/begin MEASUREMENT AION_auto_mode_request_U.control_available_get_BCS_info_get_FRWheelSpd "" FLOAT64_IEEE AION_auto_mode_request_CM_double_km_h 0 0 0 240 ECU_ADDRESS 0x00205418 /end MEASUREMENT
/begin MEASUREMENT AION_auto_mode_request_U.control_available_get_BCS_info_get_FRWheelSpdEdgesSum "" ULONG AION_auto_mode_request_CM_uint32 0 0 0 4095 ECU_ADDRESS 0x002053BC /end MEASUREMENT
/begin MEASUREMENT AION_auto_mode_request_U.control_available_get_BCS_info_get_FRWheelSpdEdgesSumVD "" UBYTE AION_auto_mode_request_CM_uint8 0 0 0 1 ECU_ADDRESS 0x002053C0 /end MEASUREMENT
/begin MEASUREMENT AION_auto_mode_request_U.control_available_get_BCS_info_get_FRWheelSpdVD "" UBYTE AION_auto_mode_request_CM_uint8 0 0 0 1 ECU_ADDRESS 0x00205420 /end MEASUREMENT
/begin MEASUREMENT AION_auto_mode_request_U.control_available_get_BCS_info_get_HDCCtrlSt "" UBYTE AION_auto_mode_request_CM_uint8__ 0 0 0 3 ECU_ADDRESS 0x002053E9 /end MEASUREMENT
/begin MEASUREMENT AION_auto_mode_request_U.control_available_get_BCS_info_get_HDCErrSt "" UBYTE AION_auto_mode_request_CM_uint8__ 0 0 0 1 ECU_ADDRESS 0x002053EA /end MEASUREMENT
/begin MEASUREMENT AION_auto_mode_request_U.control_available_get_BCS_info_get_MasterCylinderPr "" FLOAT64_IEEE AION_auto_mode_request_CM_double_bar 0 0 0 250 ECU_ADDRESS 0x002053F0 /end MEASUREMENT
/begin MEASUREMENT AION_auto_mode_request_U.control_available_get_BCS_info_get_MasterCylinderPrOffset "" FLOAT64_IEEE AION_auto_mode_request_CM_double_bar 0 0 -15 15 ECU_ADDRESS 0x002053F8 /end MEASUREMENT
/begin MEASUREMENT AION_auto_mode_request_U.control_available_get_BCS_info_get_MasterCylinderPrOffsetVD "" UBYTE AION_auto_mode_request_CM_uint8__ 0 0 0 1 ECU_ADDRESS 0x00205400 /end MEASUREMENT
/begin MEASUREMENT AION_auto_mode_request_U.control_available_get_BCS_info_get_MasterCylinderPrVD "" UBYTE AION_auto_mode_request_CM_uint8__ 0 0 0 1 ECU_ADDRESS 0x00205401 /end MEASUREMENT
/begin MEASUREMENT AION_auto_mode_request_U.control_available_get_BCS_info_get_NoBrakeForce "" UBYTE AION_auto_mode_request_CM_uint8 0 0 0 1 ECU_ADDRESS 0x00205402 /end MEASUREMENT
/begin MEASUREMENT AION_auto_mode_request_U.control_available_get_BCS_info_get_RLWheelRotatedDirection "" UBYTE AION_auto_mode_request_CM_uint8 0 0 0 1 ECU_ADDRESS 0x00205421 /end MEASUREMENT
/begin MEASUREMENT AION_auto_mode_request_U.control_available_get_BCS_info_get_RLWheelRotatedDirectionVD "" UBYTE AION_auto_mode_request_CM_uint8 0 0 0 1 ECU_ADDRESS 0x00205422 /end MEASUREMENT
/begin MEASUREMENT AION_auto_mode_request_U.control_available_get_BCS_info_get_RLWheelSpd "" FLOAT64_IEEE AION_auto_mode_request_CM_double_km_h 0 0 0 240 ECU_ADDRESS 0x00205428 /end MEASUREMENT
/begin MEASUREMENT AION_auto_mode_request_U.control_available_get_BCS_info_get_RLWheelSpdEdgesSum "" ULONG AION_auto_mode_request_CM_uint32 0 0 0 4095 ECU_ADDRESS 0x002053C4 /end MEASUREMENT
/begin MEASUREMENT AION_auto_mode_request_U.control_available_get_BCS_info_get_RLWheelSpdEdgesSumVD "" UBYTE AION_auto_mode_request_CM_uint8 0 0 0 1 ECU_ADDRESS 0x002053C8 /end MEASUREMENT
/begin MEASUREMENT AION_auto_mode_request_U.control_available_get_BCS_info_get_RLWheelSpdVD "" UBYTE AION_auto_mode_request_CM_uint8 0 0 0 1 ECU_ADDRESS 0x00205430 /end MEASUREMENT
/begin MEASUREMENT AION_auto_mode_request_U.control_available_get_BCS_info_get_RRWheelRotatedDirection "" UBYTE AION_auto_mode_request_CM_uint8 0 0 0 1 ECU_ADDRESS 0x00205431 /end MEASUREMENT
/begin MEASUREMENT AION_auto_mode_request_U.control_available_get_BCS_info_get_RRWheelRotatedDirectionVD "" UBYTE AION_auto_mode_request_CM_uint8 0 0 0 1 ECU_ADDRESS 0x00205432 /end MEASUREMENT
/begin MEASUREMENT AION_auto_mode_request_U.control_available_get_BCS_info_get_RRWheelSpd "" FLOAT64_IEEE AION_auto_mode_request_CM_double_km_h 0 0 0 240 ECU_ADDRESS 0x00205438 /end MEASUREMENT
/begin MEASUREMENT AION_auto_mode_request_U.control_available_get_BCS_info_get_RRWheelSpdEdgesSum "" ULONG AION_auto_mode_request_CM_uint32 0 0 0 4095 ECU_ADDRESS 0x002053CC /end MEASUREMENT
/begin MEASUREMENT AION_auto_mode_request_U.control_available_get_BCS_info_get_RRWheelSpdEdgesSumVD "" UBYTE AION_auto_mode_request_CM_uint8 0 0 0 1 ECU_ADDRESS 0x002053D0 /end MEASUREMENT
/begin MEASUREMENT AION_auto_mode_request_U.control_available_get_BCS_info_get_RRWheelSpdVD "" UBYTE AION_auto_mode_request_CM_uint8 0 0 0 1 ECU_ADDRESS 0x00205440 /end MEASUREMENT
/begin MEASUREMENT AION_auto_mode_request_U.control_available_get_BCS_info_get_VDCActiveSt "" UBYTE AION_auto_mode_request_CM_uint8__ 0 0 0 1 ECU_ADDRESS 0x002053A2 /end MEASUREMENT
/begin MEASUREMENT AION_auto_mode_request_U.control_available_get_BCS_info_get_VDCFaultSt "" UBYTE AION_auto_mode_request_CM_uint8__ 0 0 0 1 ECU_ADDRESS 0x002053A3 /end MEASUREMENT
/begin MEASUREMENT AION_auto_mode_request_U.control_available_get_BCS_info_get_VehLaltrlAccelOffset "" FLOAT64_IEEE AION_auto_mode_request_CM_double_m_s_2 0 0 -21.593 21.593 ECU_ADDRESS 0x00205468 /end MEASUREMENT
/begin MEASUREMENT AION_auto_mode_request_U.control_available_get_BCS_info_get_VehLongAccelOffset "" FLOAT64_IEEE AION_auto_mode_request_CM_double_m_s_2 0 0 -21.593 21.593 ECU_ADDRESS 0x00205470 /end MEASUREMENT
/begin MEASUREMENT AION_auto_mode_request_U.control_available_get_BCS_info_get_VehSpd "" FLOAT64_IEEE AION_auto_mode_request_CM_double_km_h 0 0 0 240 ECU_ADDRESS 0x002053A8 /end MEASUREMENT
/begin MEASUREMENT AION_auto_mode_request_U.control_available_get_BCS_info_get_VehSpdVD "" UBYTE AION_auto_mode_request_CM_uint8__ 0 0 0 1 ECU_ADDRESS 0x002053B0 /end MEASUREMENT
/begin MEASUREMENT AION_auto_mode_request_U.control_available_get_BCS_info_get_VehicleStandStillSt "" UBYTE AION_auto_mode_request_CM_uint8 0 0 0 3 ECU_ADDRESS 0x00205403 /end MEASUREMENT
/begin MEASUREMENT AION_auto_mode_request_U.control_available_get_BCS_info_get_YawRate "" FLOAT64_IEEE AION_auto_mode_request_CM_double_rad_s 0 0 -2.0943 1.9047234375 ECU_ADDRESS 0x002053D8 /end MEASUREMENT
/begin MEASUREMENT AION_auto_mode_request_U.control_available_get_BCS_info_get_YawRateOffset "" FLOAT64_IEEE AION_auto_mode_request_CM_double_rad_s 0 0 -0.13 0.13 ECU_ADDRESS 0x002053E0 /end MEASUREMENT
/begin MEASUREMENT AION_auto_mode_request_U.control_available_get_BCS_info_get_YawRateSt "" UBYTE AION_auto_mode_request_CM_uint8 0 0 0 1 ECU_ADDRESS 0x002053E8 /end MEASUREMENT
/begin MEASUREMENT AION_auto_mode_request_U.control_available_get_EPB_info_get_FailSt "" SLONG AION_auto_mode_request_CM_Error_status 0 0 0 1 ECU_ADDRESS 0x00205574 /end MEASUREMENT
/begin MEASUREMENT AION_auto_mode_request_U.control_available_get_EPB_info_get_SwitchSt "" UBYTE AION_auto_mode_request_CM_uint8 0 0 0 3 ECU_ADDRESS 0x00205578 /end MEASUREMENT
/begin MEASUREMENT AION_auto_mode_request_U.control_available_get_EPB_info_get_SwitchStVD "" UBYTE AION_auto_mode_request_CM_uint8 0 0 0 1 ECU_ADDRESS 0x00205579 /end MEASUREMENT
/begin MEASUREMENT AION_auto_mode_request_U.control_available_get_EPB_info_get_SysSt "" UBYTE AION_auto_mode_request_CM_uint8 0 0 0 7 ECU_ADDRESS 0x0020557A /end MEASUREMENT
/begin MEASUREMENT AION_auto_mode_request_U.control_available_get_EPS_info_get_SteeringAngle "" FLOAT64_IEEE AION_auto_mode_request_CM_double_deg 0 0 -780 779.9 ECU_ADDRESS 0x00205580 /end MEASUREMENT
/begin MEASUREMENT AION_auto_mode_request_U.control_available_get_EPS_info_get_SteeringAngleSpd "" ULONG AION_auto_mode_request_CM_uint32_deg_sec 0 0 0 1016 ECU_ADDRESS 0x00205588 /end MEASUREMENT
/begin MEASUREMENT AION_auto_mode_request_U.control_available_get_EPS_info_get_SteeringAngleSpdVD "" UBYTE AION_auto_mode_request_CM_uint8 0 0 0 1 ECU_ADDRESS 0x0020558C /end MEASUREMENT
/begin MEASUREMENT AION_auto_mode_request_U.control_available_get_EPS_info_get_SteeringAngleVD "" UBYTE AION_auto_mode_request_CM_uint8 0 0 0 1 ECU_ADDRESS 0x0020558D /end MEASUREMENT
/begin MEASUREMENT AION_auto_mode_request_U.control_available_get_EPS_info_get_StrngWhlTorq "" FLOAT64_IEEE AION_auto_mode_request_CM_double_Nm 0 0 -12.5 12.5 ECU_ADDRESS 0x00205590 /end MEASUREMENT
/begin MEASUREMENT AION_auto_mode_request_U.control_available_get_EPS_info_get_StrngWhlTorqVD "" UBYTE AION_auto_mode_request_CM_uint8 0 0 0 1 ECU_ADDRESS 0x00205598 /end MEASUREMENT
/begin MEASUREMENT AION_auto_mode_request_U.control_available_get_EPS_info_get_ThermalSt "" UBYTE AION_auto_mode_request_CM_uint8 0 0 0 3 ECU_ADDRESS 0x00205599 /end MEASUREMENT
/begin MEASUREMENT AION_auto_mode_request_U.control_available_get_EPS_info_get_WarnLamp "" UBYTE AION_auto_mode_request_CM_uint8 0 0 0 1 ECU_ADDRESS 0x0020559A /end MEASUREMENT
/begin MEASUREMENT AION_auto_mode_request_U.control_available_get_SCU_info_get_Checksum1 "" ULONG AION_auto_mode_request_CM_uint32__ 0 0 0 255 ECU_ADDRESS 0x002054D4 /end MEASUREMENT
/begin MEASUREMENT AION_auto_mode_request_U.control_available_get_SCU_info_get_Checksum10 "" ULONG AION_auto_mode_request_CM_uint32 0 0 0 255 ECU_ADDRESS 0x002054DC /end MEASUREMENT
/begin MEASUREMENT AION_auto_mode_request_U.control_available_get_SCU_info_get_Checksum11 "" ULONG AION_auto_mode_request_CM_uint32 0 0 0 255 ECU_ADDRESS 0x002054E4 /end MEASUREMENT
/begin MEASUREMENT AION_auto_mode_request_U.control_available_get_SCU_info_get_Checksum12 "" ULONG AION_auto_mode_request_CM_uint32 0 0 0 255 ECU_ADDRESS 0x002054EC /end MEASUREMENT
/begin MEASUREMENT AION_auto_mode_request_U.control_available_get_SCU_info_get_Checksum13 "" ULONG AION_auto_mode_request_CM_uint32 0 0 0 255 ECU_ADDRESS 0x002054F4 /end MEASUREMENT
/begin MEASUREMENT AION_auto_mode_request_U.control_available_get_SCU_info_get_Checksum16 "" ULONG AION_auto_mode_request_CM_uint32__ 0 0 0 205 ECU_ADDRESS 0x0020551C /end MEASUREMENT
/begin MEASUREMENT AION_auto_mode_request_U.control_available_get_SCU_info_get_Checksum17 "" ULONG AION_auto_mode_request_CM_uint32__ 0 0 0 255 ECU_ADDRESS 0x00205524 /end MEASUREMENT
/begin MEASUREMENT AION_auto_mode_request_U.control_available_get_SCU_info_get_Checksum18 "" ULONG AION_auto_mode_request_CM_uint32__ 0 0 0 255 ECU_ADDRESS 0x0020552C /end MEASUREMENT
/begin MEASUREMENT AION_auto_mode_request_U.control_available_get_SCU_info_get_Checksum2 "" ULONG AION_auto_mode_request_CM_uint32 0 0 0 255 ECU_ADDRESS 0x00205534 /end MEASUREMENT
/begin MEASUREMENT AION_auto_mode_request_U.control_available_get_SCU_info_get_Checksum3 "" ULONG AION_auto_mode_request_CM_uint32 0 0 0 255 ECU_ADDRESS 0x0020553C /end MEASUREMENT
/begin MEASUREMENT AION_auto_mode_request_U.control_available_get_SCU_info_get_Checksum4 "" ULONG AION_auto_mode_request_CM_uint32__ 0 0 0 255 ECU_ADDRESS 0x00205544 /end MEASUREMENT
/begin MEASUREMENT AION_auto_mode_request_U.control_available_get_SCU_info_get_Checksum5 "" ULONG AION_auto_mode_request_CM_uint32__ 0 0 0 255 ECU_ADDRESS 0x0020554C /end MEASUREMENT
/begin MEASUREMENT AION_auto_mode_request_U.control_available_get_SCU_info_get_Checksum6 "" ULONG AION_auto_mode_request_CM_uint32 0 0 0 255 ECU_ADDRESS 0x00205554 /end MEASUREMENT
/begin MEASUREMENT AION_auto_mode_request_U.control_available_get_SCU_info_get_Checksum7 "" ULONG AION_auto_mode_request_CM_uint32 0 0 0 255 ECU_ADDRESS 0x0020555C /end MEASUREMENT
/begin MEASUREMENT AION_auto_mode_request_U.control_available_get_SCU_info_get_Checksum8 "" ULONG AION_auto_mode_request_CM_uint32 0 0 0 255 ECU_ADDRESS 0x00205564 /end MEASUREMENT
/begin MEASUREMENT AION_auto_mode_request_U.control_available_get_SCU_info_get_Checksum9 "" ULONG AION_auto_mode_request_CM_uint32 0 0 0 255 ECU_ADDRESS 0x0020556C /end MEASUREMENT
/begin MEASUREMENT AION_auto_mode_request_U.control_available_get_SCU_info_get_EStopSwSt "" UBYTE AION_auto_mode_request_CM_uint8 0 0 0 1 ECU_ADDRESS 0x002054FC /end MEASUREMENT
/begin MEASUREMENT AION_auto_mode_request_U.control_available_get_SCU_info_get_EStopSwStVD "" UBYTE AION_auto_mode_request_CM_uint8 0 0 0 1 ECU_ADDRESS 0x002054FD /end MEASUREMENT
/begin MEASUREMENT AION_auto_mode_request_U.control_available_get_SCU_info_get_LatAutoCheckReport "" ULONG AION_auto_mode_request_CM_uint32 0 0 0 15 ECU_ADDRESS 0x00205500 /end MEASUREMENT
/begin MEASUREMENT AION_auto_mode_request_U.control_available_get_SCU_info_get_LatCtrlMode "" SLONG AION_auto_mode_request_CM_Control_status 0 0 0 3 ECU_ADDRESS 0x00205504 /end MEASUREMENT
/begin MEASUREMENT AION_auto_mode_request_U.control_available_get_SCU_info_get_LatQuitReport "" ULONG AION_auto_mode_request_CM_uint32 0 0 0 255 ECU_ADDRESS 0x00205508 /end MEASUREMENT
/begin MEASUREMENT AION_auto_mode_request_U.control_available_get_SCU_info_get_LngAutoCheckIReport "" ULONG AION_auto_mode_request_CM_uint32 0 0 0 65535 ECU_ADDRESS 0x0020550C /end MEASUREMENT
/begin MEASUREMENT AION_auto_mode_request_U.control_available_get_SCU_info_get_LngCtrlMode "" SLONG AION_auto_mode_request_CM_Control_status 0 0 0 3 ECU_ADDRESS 0x00205510 /end MEASUREMENT
/begin MEASUREMENT AION_auto_mode_request_U.control_available_get_SCU_info_get_LngQuitReport "" ULONG AION_auto_mode_request_CM_uint32 0 0 0 65535 ECU_ADDRESS 0x00205514 /end MEASUREMENT
/begin MEASUREMENT AION_auto_mode_request_U.control_available_get_SCU_info_get_MsgCounter1 "" ULONG AION_auto_mode_request_CM_uint32__ 0 0 0 15 ECU_ADDRESS 0x002054D8 /end MEASUREMENT
/begin MEASUREMENT AION_auto_mode_request_U.control_available_get_SCU_info_get_MsgCounter10 "" ULONG AION_auto_mode_request_CM_uint32 0 0 0 15 ECU_ADDRESS 0x002054E0 /end MEASUREMENT
/begin MEASUREMENT AION_auto_mode_request_U.control_available_get_SCU_info_get_MsgCounter11 "" ULONG AION_auto_mode_request_CM_uint32 0 0 0 15 ECU_ADDRESS 0x002054E8 /end MEASUREMENT
/begin MEASUREMENT AION_auto_mode_request_U.control_available_get_SCU_info_get_MsgCounter12 "" ULONG AION_auto_mode_request_CM_uint32 0 0 0 15 ECU_ADDRESS 0x002054F0 /end MEASUREMENT
/begin MEASUREMENT AION_auto_mode_request_U.control_available_get_SCU_info_get_MsgCounter13 "" ULONG AION_auto_mode_request_CM_uint32 0 0 0 15 ECU_ADDRESS 0x002054F8 /end MEASUREMENT
/begin MEASUREMENT AION_auto_mode_request_U.control_available_get_SCU_info_get_MsgCounter16 "" ULONG AION_auto_mode_request_CM_uint32__ 0 0 0 15 ECU_ADDRESS 0x00205520 /end MEASUREMENT
/begin MEASUREMENT AION_auto_mode_request_U.control_available_get_SCU_info_get_MsgCounter17 "" ULONG AION_auto_mode_request_CM_uint32__ 0 0 0 15 ECU_ADDRESS 0x00205528 /end MEASUREMENT
/begin MEASUREMENT AION_auto_mode_request_U.control_available_get_SCU_info_get_MsgCounter18 "" ULONG AION_auto_mode_request_CM_uint32__ 0 0 0 15 ECU_ADDRESS 0x00205530 /end MEASUREMENT
/begin MEASUREMENT AION_auto_mode_request_U.control_available_get_SCU_info_get_MsgCounter2 "" ULONG AION_auto_mode_request_CM_uint32 0 0 0 15 ECU_ADDRESS 0x00205538 /end MEASUREMENT
/begin MEASUREMENT AION_auto_mode_request_U.control_available_get_SCU_info_get_MsgCounter3 "" ULONG AION_auto_mode_request_CM_uint32 0 0 0 15 ECU_ADDRESS 0x00205540 /end MEASUREMENT
/begin MEASUREMENT AION_auto_mode_request_U.control_available_get_SCU_info_get_MsgCounter4 "" ULONG AION_auto_mode_request_CM_uint32__ 0 0 0 15 ECU_ADDRESS 0x00205548 /end MEASUREMENT
/begin MEASUREMENT AION_auto_mode_request_U.control_available_get_SCU_info_get_MsgCounter5 "" ULONG AION_auto_mode_request_CM_uint32 0 0 0 15 ECU_ADDRESS 0x00205550 /end MEASUREMENT
/begin MEASUREMENT AION_auto_mode_request_U.control_available_get_SCU_info_get_MsgCounter6 "" ULONG AION_auto_mode_request_CM_uint32 0 0 0 15 ECU_ADDRESS 0x00205558 /end MEASUREMENT
/begin MEASUREMENT AION_auto_mode_request_U.control_available_get_SCU_info_get_MsgCounter7 "" ULONG AION_auto_mode_request_CM_uint32 0 0 0 15 ECU_ADDRESS 0x00205560 /end MEASUREMENT
/begin MEASUREMENT AION_auto_mode_request_U.control_available_get_SCU_info_get_MsgCounter8 "" ULONG AION_auto_mode_request_CM_uint32 0 0 0 15 ECU_ADDRESS 0x00205568 /end MEASUREMENT
/begin MEASUREMENT AION_auto_mode_request_U.control_available_get_SCU_info_get_MsgCounter9 "" ULONG AION_auto_mode_request_CM_uint32 0 0 0 15 ECU_ADDRESS 0x00205570 /end MEASUREMENT
/begin MEASUREMENT AION_auto_mode_request_U.control_available_get_SCU_info_get_StrngWhlIntv "" UBYTE AION_auto_mode_request_CM_uint8 0 0 0 1 ECU_ADDRESS 0x00205518 /end MEASUREMENT
/begin MEASUREMENT AION_auto_mode_request_U.control_available_get_SRS_info_get_DriverSeatBeltSt "" UBYTE AION_auto_mode_request_CM_uint8 0 0 0 3 ECU_ADDRESS 0x0020557B /end MEASUREMENT
/begin MEASUREMENT AION_auto_mode_request_U.control_available_get_SRS_info_get_PsngrSeatBeltSt "" UBYTE AION_auto_mode_request_CM_uint8 0 0 0 3 ECU_ADDRESS 0x0020557C /end MEASUREMENT
/begin MEASUREMENT AION_auto_mode_request_U.control_available_get_VCU_info_get_ACCButtInfo "" ULONG AION_auto_mode_request_CM_uint32 0 0 0 255 ECU_ADDRESS 0x002054A4 /end MEASUREMENT
/begin MEASUREMENT AION_auto_mode_request_U.control_available_get_VCU_info_get_ACCMaxRecpDecel "" FLOAT64_IEEE AION_auto_mode_request_CM_double_m_s2 0 0 -5 7.75 ECU_ADDRESS 0x00205490 /end MEASUREMENT
/begin MEASUREMENT AION_auto_mode_request_U.control_available_get_VCU_info_get_ACCMaxRecpDecelVD "" UBYTE AION_auto_mode_request_CM_uint8 0 0 0 1 ECU_ADDRESS 0x00205498 /end MEASUREMENT
/begin MEASUREMENT AION_auto_mode_request_U.control_available_get_VCU_info_get_AccElecECFail "" UBYTE AION_auto_mode_request_CM_uint8__ 0 0 0 1 ECU_ADDRESS 0x002054A8 /end MEASUREMENT
/begin MEASUREMENT AION_auto_mode_request_U.control_available_get_VCU_info_get_ActRecpTorq "" ULONG AION_auto_mode_request_CM_uint32_Nm 0 0 0 2000 ECU_ADDRESS 0x00205484 /end MEASUREMENT
/begin MEASUREMENT AION_auto_mode_request_U.control_available_get_VCU_info_get_ActRecpTorqSt "" UBYTE AION_auto_mode_request_CM_uint8 0 0 0 3 ECU_ADDRESS 0x00205488 /end MEASUREMENT
/begin MEASUREMENT AION_auto_mode_request_U.control_available_get_VCU_info_get_ActVehWheelTorq "" ULONG AION_auto_mode_request_CM_uint32_Nm 0 0 0 10000 ECU_ADDRESS 0x0020549C /end MEASUREMENT
/begin MEASUREMENT AION_auto_mode_request_U.control_available_get_VCU_info_get_BrkPedalSt "" UBYTE AION_auto_mode_request_CM_uint8 0 0 0 1 ECU_ADDRESS 0x002054C0 /end MEASUREMENT
/begin MEASUREMENT AION_auto_mode_request_U.control_available_get_VCU_info_get_BrkPedalStVD "" UBYTE AION_auto_mode_request_CM_uint8 0 0 0 1 ECU_ADDRESS 0x002054C1 /end MEASUREMENT
/begin MEASUREMENT AION_auto_mode_request_U.control_available_get_VCU_info_get_CrntGearLvl "" UBYTE AION_auto_mode_request_CM_uint8 0 0 0 7 ECU_ADDRESS 0x00205489 /end MEASUREMENT
/begin MEASUREMENT AION_auto_mode_request_U.control_available_get_VCU_info_get_CrntGearLvlVD "" UBYTE AION_auto_mode_request_CM_uint8 0 0 0 1 ECU_ADDRESS 0x0020548A /end MEASUREMENT
/begin MEASUREMENT AION_auto_mode_request_U.control_available_get_VCU_info_get_GasPedalActPst "" FLOAT64_IEEE AION_auto_mode_request_CM_double__ 0 0 0 99.96 ECU_ADDRESS 0x002054B0 /end MEASUREMENT
/begin MEASUREMENT AION_auto_mode_request_U.control_available_get_VCU_info_get_GasPedalActPstVD "" UBYTE AION_auto_mode_request_CM_uint8 0 0 0 1 ECU_ADDRESS 0x002054B8 /end MEASUREMENT
/begin MEASUREMENT AION_auto_mode_request_U.control_available_get_VCU_info_get_GasPedalVirtualPst "" FLOAT64_IEEE AION_auto_mode_request_CM_double__ 0 0 0 99.96 ECU_ADDRESS 0x002054C8 /end MEASUREMENT
/begin MEASUREMENT AION_auto_mode_request_U.control_available_get_VCU_info_get_GasPedalVirtualPstVD "" UBYTE AION_auto_mode_request_CM_uint8 0 0 0 1 ECU_ADDRESS 0x002054D0 /end MEASUREMENT
/begin MEASUREMENT AION_auto_mode_request_U.control_available_get_VCU_info_get_GearLeverIntv "" UBYTE AION_auto_mode_request_CM_uint8 0 0 0 1 ECU_ADDRESS 0x00205478 /end MEASUREMENT
/begin MEASUREMENT AION_auto_mode_request_U.control_available_get_VCU_info_get_LateralAssistBtnInfo "" UBYTE AION_auto_mode_request_CM_uint8 0 0 0 1 ECU_ADDRESS 0x002054A0 /end MEASUREMENT
/begin MEASUREMENT AION_auto_mode_request_U.control_available_get_VCU_info_get_LateralAssistBtnInfoVD "" UBYTE AION_auto_mode_request_CM_uint8 0 0 0 1 ECU_ADDRESS 0x002054A1 /end MEASUREMENT
/begin MEASUREMENT AION_auto_mode_request_U.control_available_get_VCU_info_get_VehDrvMod "" UBYTE AION_auto_mode_request_CM_uint8__ 0 0 0 7 ECU_ADDRESS 0x00205479 /end MEASUREMENT
/begin MEASUREMENT AION_auto_mode_request_U.control_available_get_VCU_info_get_VehRdySt "" SLONG AION_auto_mode_request_CM_Ready_status__ 0 0 0 1 ECU_ADDRESS 0x0020547C /end MEASUREMENT
/begin MEASUREMENT AION_auto_mode_request_U.control_available_get_VCU_info_get_VehRng "" ULONG AION_auto_mode_request_CM_uint32_km 0 0 0 1000 ECU_ADDRESS 0x00205480 /end MEASUREMENT
/begin MEASUREMENT AION_auto_mode_request_U.control_available_get_VCU_info_get_VehWheelTorqMax "" ULONG AION_auto_mode_request_CM_uint32_Nm 0 0 0 10000 ECU_ADDRESS 0x002054BC /end MEASUREMENT
/begin MEASUREMENT AION_auto_mode_request_U.control_available_set_ADCU_info_set_BeamReq "" SLONG AION_auto_mode_request_CM_Beam_request__ 0 0 0 3 ECU_ADDRESS 0x00205390 /end MEASUREMENT
/begin MEASUREMENT AION_auto_mode_request_U.control_available_set_ADCU_info_set_BodyCtrlReq "" SLONG AION_auto_mode_request_CM_Enable_request__ 0 0 0 1 ECU_ADDRESS 0x00205394 /end MEASUREMENT
/begin MEASUREMENT AION_auto_mode_request_U.control_available_set_ADCU_info_set_Checksum1 "" ULONG AION_auto_mode_request_CM_uint32 0 0 0 255 ECU_ADDRESS 0x00205378 /end MEASUREMENT
/begin MEASUREMENT AION_auto_mode_request_U.control_available_set_ADCU_info_set_Checksum2 "" ULONG AION_auto_mode_request_CM_uint32 0 0 0 255 ECU_ADDRESS 0x00205380 /end MEASUREMENT
/begin MEASUREMENT AION_auto_mode_request_U.control_available_set_ADCU_info_set_Checksum3 "" ULONG AION_auto_mode_request_CM_uint32__ 0 0 0 255 ECU_ADDRESS 0x00205388 /end MEASUREMENT
/begin MEASUREMENT AION_auto_mode_request_U.control_available_set_ADCU_info_set_HornRingReq "" SLONG AION_auto_mode_request_CM_Active_request__ 0 0 0 1 ECU_ADDRESS 0x00205398 /end MEASUREMENT
/begin MEASUREMENT AION_auto_mode_request_U.control_available_set_ADCU_info_set_MsgCounter1 "" ULONG AION_auto_mode_request_CM_uint32 0 0 0 15 ECU_ADDRESS 0x0020537C /end MEASUREMENT
/begin MEASUREMENT AION_auto_mode_request_U.control_available_set_ADCU_info_set_MsgCounter2 "" ULONG AION_auto_mode_request_CM_uint32 0 0 0 15 ECU_ADDRESS 0x00205384 /end MEASUREMENT
/begin MEASUREMENT AION_auto_mode_request_U.control_available_set_ADCU_info_set_MsgCounter3 "" ULONG AION_auto_mode_request_CM_uint32__ 0 0 0 15 ECU_ADDRESS 0x0020538C /end MEASUREMENT
/begin MEASUREMENT AION_auto_mode_request_U.control_available_set_ADCU_info_set_TurnLightReq "" SLONG AION_auto_mode_request_CM_Light_request__ 0 0 0 3 ECU_ADDRESS 0x0020539C /end MEASUREMENT
/begin MEASUREMENT AION_auto_mode_request_U.control_available_set_lateral_control_info_set_LatCtrlReq "" SLONG AION_auto_mode_request_CM_Control_request 0 0 0 3 ECU_ADDRESS 0x00205340 /end MEASUREMENT
/begin MEASUREMENT AION_auto_mode_request_U.control_available_set_lateral_control_info_set_SteerAngReq "" FLOAT64_IEEE AION_auto_mode_request_CM_double 0 0 -1.7E+308 1.7E+308 ECU_ADDRESS 0x00205350 /end MEASUREMENT
/begin MEASUREMENT AION_auto_mode_request_U.control_available_set_lateral_control_info_set_SteerAngSpdLimt "" FLOAT64_IEEE AION_auto_mode_request_CM_double 0 0 -1.7E+308 1.7E+308 ECU_ADDRESS 0x00205358 /end MEASUREMENT
/begin MEASUREMENT AION_auto_mode_request_U.control_available_set_lateral_control_info_set_SteerWhlTorqReq "" FLOAT64_IEEE AION_auto_mode_request_CM_double 0 0 -1.7E+308 1.7E+308 ECU_ADDRESS 0x00205348 /end MEASUREMENT
/begin MEASUREMENT AION_auto_mode_request_U.control_available_set_longitudinal_control_info_set_AutoTrqWhlReq "" SLONG AION_auto_mode_request_CM_int32 0 0 0 [] ECU_ADDRESS 0x00205364 /end MEASUREMENT
/begin MEASUREMENT AION_auto_mode_request_U.control_available_set_longitudinal_control_info_set_BrakeReq "" FLOAT64_IEEE AION_auto_mode_request_CM_double 0 0 0 [] ECU_ADDRESS 0x00205368 /end MEASUREMENT
/begin MEASUREMENT AION_auto_mode_request_U.control_available_set_longitudinal_control_info_set_GearLvlReq "" SLONG AION_auto_mode_request_CM_AION_gear 0 0 0 7 ECU_ADDRESS 0x00205370 /end MEASUREMENT
/begin MEASUREMENT AION_auto_mode_request_U.control_available_set_longitudinal_control_info_set_GearLvlReqVD "" SLONG AION_auto_mode_request_CM_Validation_status 0 0 0 1 ECU_ADDRESS 0x00205374 /end MEASUREMENT
/begin MEASUREMENT AION_auto_mode_request_U.control_available_set_longitudinal_control_info_set_LngCtrlReq "" SLONG AION_auto_mode_request_CM_Control_request 0 0 0 3 ECU_ADDRESS 0x00205360 /end MEASUREMENT
/begin MEASUREMENT AION_auto_mode_request_Y.OutBus_get_BCM_info_get_CtrlAvailable "" SLONG AION_auto_mode_request_CM_Available_status 0 0 0 1 ECU_ADDRESS 0x0020531C /end MEASUREMENT
/begin MEASUREMENT AION_auto_mode_request_Y.OutBus_get_BCM_info_get_DriverDoorAjarSt "" UBYTE AION_auto_mode_request_CM_uint8 0 0 0 1 ECU_ADDRESS 0x00205320 /end MEASUREMENT
/begin MEASUREMENT AION_auto_mode_request_Y.OutBus_get_BCM_info_get_FrontFogLampSt "" UBYTE AION_auto_mode_request_CM_uint8 0 0 0 1 ECU_ADDRESS 0x00205321 /end MEASUREMENT
/begin MEASUREMENT AION_auto_mode_request_Y.OutBus_get_BCM_info_get_FrontWiperSt "" UBYTE AION_auto_mode_request_CM_uint8 0 0 0 3 ECU_ADDRESS 0x00205322 /end MEASUREMENT
/begin MEASUREMENT AION_auto_mode_request_Y.OutBus_get_BCM_info_get_HazardLampSt "" UBYTE AION_auto_mode_request_CM_uint8 0 0 0 1 ECU_ADDRESS 0x00205323 /end MEASUREMENT
/begin MEASUREMENT AION_auto_mode_request_Y.OutBus_get_BCM_info_get_HighBeamSt "" UBYTE AION_auto_mode_request_CM_uint8 0 0 0 1 ECU_ADDRESS 0x00205324 /end MEASUREMENT
/begin MEASUREMENT AION_auto_mode_request_Y.OutBus_get_BCM_info_get_HornSt "" UBYTE AION_auto_mode_request_CM_uint8 0 0 0 1 ECU_ADDRESS 0x00205325 /end MEASUREMENT
/begin MEASUREMENT AION_auto_mode_request_Y.OutBus_get_BCM_info_get_KeySt "" UBYTE AION_auto_mode_request_CM_uint8 0 0 0 3 ECU_ADDRESS 0x00205326 /end MEASUREMENT
/begin MEASUREMENT AION_auto_mode_request_Y.OutBus_get_BCM_info_get_LeftTurnLampFaultSt "" SLONG AION_auto_mode_request_CM_Fault_status 0 0 0 1 ECU_ADDRESS 0x00205328 /end MEASUREMENT
/begin MEASUREMENT AION_auto_mode_request_Y.OutBus_get_BCM_info_get_LeftTurnLampSt "" UBYTE AION_auto_mode_request_CM_uint8 0 0 0 1 ECU_ADDRESS 0x0020532C /end MEASUREMENT
/begin MEASUREMENT AION_auto_mode_request_Y.OutBus_get_BCM_info_get_LowBeamSt "" UBYTE AION_auto_mode_request_CM_uint8 0 0 0 1 ECU_ADDRESS 0x0020532D /end MEASUREMENT
/begin MEASUREMENT AION_auto_mode_request_Y.OutBus_get_BCM_info_get_PsngrDoorAjarSt "" UBYTE AION_auto_mode_request_CM_uint8 0 0 0 1 ECU_ADDRESS 0x0020532E /end MEASUREMENT
/begin MEASUREMENT AION_auto_mode_request_Y.OutBus_get_BCM_info_get_RLDoorAjarSt "" UBYTE AION_auto_mode_request_CM_uint8 0 0 0 1 ECU_ADDRESS 0x0020532F /end MEASUREMENT
/begin MEASUREMENT AION_auto_mode_request_Y.OutBus_get_BCM_info_get_RRDoorAjarSt "" UBYTE AION_auto_mode_request_CM_uint8 0 0 0 1 ECU_ADDRESS 0x00205330 /end MEASUREMENT
/begin MEASUREMENT AION_auto_mode_request_Y.OutBus_get_BCM_info_get_RearFogLampSt "" UBYTE AION_auto_mode_request_CM_uint8 0 0 0 1 ECU_ADDRESS 0x00205331 /end MEASUREMENT
/begin MEASUREMENT AION_auto_mode_request_Y.OutBus_get_BCM_info_get_RightTurnLampFaultSt "" SLONG AION_auto_mode_request_CM_Fault_status 0 0 0 1 ECU_ADDRESS 0x00205334 /end MEASUREMENT
/begin MEASUREMENT AION_auto_mode_request_Y.OutBus_get_BCM_info_get_RightTurnLampSt "" UBYTE AION_auto_mode_request_CM_uint8 0 0 0 1 ECU_ADDRESS 0x00205338 /end MEASUREMENT
/begin MEASUREMENT AION_auto_mode_request_Y.OutBus_get_BCS_info_get_ABSActiveSt "" UBYTE AION_auto_mode_request_CM_uint8__ 0 0 0 1 ECU_ADDRESS 0x00205120 /end MEASUREMENT
/begin MEASUREMENT AION_auto_mode_request_Y.OutBus_get_BCS_info_get_ABSFaultSt "" UBYTE AION_auto_mode_request_CM_uint8__ 0 0 0 1 ECU_ADDRESS 0x00205121 /end MEASUREMENT
/begin MEASUREMENT AION_auto_mode_request_Y.OutBus_get_BCS_info_get_AEBActive "" UBYTE AION_auto_mode_request_CM_uint8 0 0 0 1 ECU_ADDRESS 0x0020516B /end MEASUREMENT
/begin MEASUREMENT AION_auto_mode_request_Y.OutBus_get_BCS_info_get_AEBAvailable "" UBYTE AION_auto_mode_request_CM_uint8 0 0 0 1 ECU_ADDRESS 0x0020516C /end MEASUREMENT
/begin MEASUREMENT AION_auto_mode_request_Y.OutBus_get_BCS_info_get_ActVehLaltrlAccel "" FLOAT64_IEEE AION_auto_mode_request_CM_double_m_s_2 0 0 -21.593 21.593 ECU_ADDRESS 0x002051C8 /end MEASUREMENT
/begin MEASUREMENT AION_auto_mode_request_Y.OutBus_get_BCS_info_get_ActVehLaltrlAccelVD "" UBYTE AION_auto_mode_request_CM_uint8 0 0 0 1 ECU_ADDRESS 0x002051D0 /end MEASUREMENT
/begin MEASUREMENT AION_auto_mode_request_Y.OutBus_get_BCS_info_get_ActVehLongAccel "" FLOAT64_IEEE AION_auto_mode_request_CM_double_m_s_2 0 0 -21.593 21.593 ECU_ADDRESS 0x002051D8 /end MEASUREMENT
/begin MEASUREMENT AION_auto_mode_request_Y.OutBus_get_BCS_info_get_ActVehLongAccelVD "" UBYTE AION_auto_mode_request_CM_uint8 0 0 0 1 ECU_ADDRESS 0x002051E0 /end MEASUREMENT
/begin MEASUREMENT AION_auto_mode_request_Y.OutBus_get_BCS_info_get_CDDActive "" UBYTE AION_auto_mode_request_CM_uint8 0 0 0 1 ECU_ADDRESS 0x0020516D /end MEASUREMENT
/begin MEASUREMENT AION_auto_mode_request_Y.OutBus_get_BCS_info_get_CDDAvailable "" UBYTE AION_auto_mode_request_CM_uint8 0 0 0 1 ECU_ADDRESS 0x0020516E /end MEASUREMENT
/begin MEASUREMENT AION_auto_mode_request_Y.OutBus_get_BCS_info_get_CDDFail "" UBYTE AION_auto_mode_request_CM_uint8 0 0 0 1 ECU_ADDRESS 0x0020516F /end MEASUREMENT
/begin MEASUREMENT AION_auto_mode_request_Y.OutBus_get_BCS_info_get_FLWheelRotatedDirection "" UBYTE AION_auto_mode_request_CM_uint8 0 0 0 1 ECU_ADDRESS 0x00205184 /end MEASUREMENT
/begin MEASUREMENT AION_auto_mode_request_Y.OutBus_get_BCS_info_get_FLWheelRotatedDirectionVD "" UBYTE AION_auto_mode_request_CM_uint8 0 0 0 1 ECU_ADDRESS 0x00205185 /end MEASUREMENT
/begin MEASUREMENT AION_auto_mode_request_Y.OutBus_get_BCS_info_get_FLWheelSpd "" FLOAT64_IEEE AION_auto_mode_request_CM_double_km_h 0 0 0 240 ECU_ADDRESS 0x00205188 /end MEASUREMENT
/begin MEASUREMENT AION_auto_mode_request_Y.OutBus_get_BCS_info_get_FLWheelSpdEdgesSum "" ULONG AION_auto_mode_request_CM_uint32 0 0 0 4095 ECU_ADDRESS 0x00205134 /end MEASUREMENT
/begin MEASUREMENT AION_auto_mode_request_Y.OutBus_get_BCS_info_get_FLWheelSpdEdgesSumVD "" UBYTE AION_auto_mode_request_CM_uint8 0 0 0 1 ECU_ADDRESS 0x00205138 /end MEASUREMENT
/begin MEASUREMENT AION_auto_mode_request_Y.OutBus_get_BCS_info_get_FLWheelSpdVD "" UBYTE AION_auto_mode_request_CM_uint8 0 0 0 1 ECU_ADDRESS 0x00205190 /end MEASUREMENT
/begin MEASUREMENT AION_auto_mode_request_Y.OutBus_get_BCS_info_get_FRWheelRotatedDirection "" UBYTE AION_auto_mode_request_CM_uint8 0 0 0 1 ECU_ADDRESS 0x00205191 /end MEASUREMENT
/begin MEASUREMENT AION_auto_mode_request_Y.OutBus_get_BCS_info_get_FRWheelRotatedDirectionVD "" UBYTE AION_auto_mode_request_CM_uint8 0 0 0 1 ECU_ADDRESS 0x00205192 /end MEASUREMENT
/begin MEASUREMENT AION_auto_mode_request_Y.OutBus_get_BCS_info_get_FRWheelSpd "" FLOAT64_IEEE AION_auto_mode_request_CM_double_km_h 0 0 0 240 ECU_ADDRESS 0x00205198 /end MEASUREMENT
/begin MEASUREMENT AION_auto_mode_request_Y.OutBus_get_BCS_info_get_FRWheelSpdEdgesSum "" ULONG AION_auto_mode_request_CM_uint32 0 0 0 4095 ECU_ADDRESS 0x0020513C /end MEASUREMENT
/begin MEASUREMENT AION_auto_mode_request_Y.OutBus_get_BCS_info_get_FRWheelSpdEdgesSumVD "" UBYTE AION_auto_mode_request_CM_uint8 0 0 0 1 ECU_ADDRESS 0x00205140 /end MEASUREMENT
/begin MEASUREMENT AION_auto_mode_request_Y.OutBus_get_BCS_info_get_FRWheelSpdVD "" UBYTE AION_auto_mode_request_CM_uint8 0 0 0 1 ECU_ADDRESS 0x002051A0 /end MEASUREMENT
/begin MEASUREMENT AION_auto_mode_request_Y.OutBus_get_BCS_info_get_HDCCtrlSt "" UBYTE AION_auto_mode_request_CM_uint8__ 0 0 0 3 ECU_ADDRESS 0x00205169 /end MEASUREMENT
/begin MEASUREMENT AION_auto_mode_request_Y.OutBus_get_BCS_info_get_HDCErrSt "" UBYTE AION_auto_mode_request_CM_uint8__ 0 0 0 1 ECU_ADDRESS 0x0020516A /end MEASUREMENT
/begin MEASUREMENT AION_auto_mode_request_Y.OutBus_get_BCS_info_get_MasterCylinderPr "" FLOAT64_IEEE AION_auto_mode_request_CM_double_bar 0 0 0 250 ECU_ADDRESS 0x00205170 /end MEASUREMENT
/begin MEASUREMENT AION_auto_mode_request_Y.OutBus_get_BCS_info_get_MasterCylinderPrOffset "" FLOAT64_IEEE AION_auto_mode_request_CM_double_bar 0 0 -15 15 ECU_ADDRESS 0x00205178 /end MEASUREMENT
/begin MEASUREMENT AION_auto_mode_request_Y.OutBus_get_BCS_info_get_MasterCylinderPrOffsetVD "" UBYTE AION_auto_mode_request_CM_uint8__ 0 0 0 1 ECU_ADDRESS 0x00205180 /end MEASUREMENT
/begin MEASUREMENT AION_auto_mode_request_Y.OutBus_get_BCS_info_get_MasterCylinderPrVD "" UBYTE AION_auto_mode_request_CM_uint8__ 0 0 0 1 ECU_ADDRESS 0x00205181 /end MEASUREMENT
/begin MEASUREMENT AION_auto_mode_request_Y.OutBus_get_BCS_info_get_NoBrakeForce "" UBYTE AION_auto_mode_request_CM_uint8 0 0 0 1 ECU_ADDRESS 0x00205182 /end MEASUREMENT
/begin MEASUREMENT AION_auto_mode_request_Y.OutBus_get_BCS_info_get_RLWheelRotatedDirection "" UBYTE AION_auto_mode_request_CM_uint8 0 0 0 1 ECU_ADDRESS 0x002051A1 /end MEASUREMENT
/begin MEASUREMENT AION_auto_mode_request_Y.OutBus_get_BCS_info_get_RLWheelRotatedDirectionVD "" UBYTE AION_auto_mode_request_CM_uint8 0 0 0 1 ECU_ADDRESS 0x002051A2 /end MEASUREMENT
/begin MEASUREMENT AION_auto_mode_request_Y.OutBus_get_BCS_info_get_RLWheelSpd "" FLOAT64_IEEE AION_auto_mode_request_CM_double_km_h 0 0 0 240 ECU_ADDRESS 0x002051A8 /end MEASUREMENT
/begin MEASUREMENT AION_auto_mode_request_Y.OutBus_get_BCS_info_get_RLWheelSpdEdgesSum "" ULONG AION_auto_mode_request_CM_uint32 0 0 0 4095 ECU_ADDRESS 0x00205144 /end MEASUREMENT
/begin MEASUREMENT AION_auto_mode_request_Y.OutBus_get_BCS_info_get_RLWheelSpdEdgesSumVD "" UBYTE AION_auto_mode_request_CM_uint8 0 0 0 1 ECU_ADDRESS 0x00205148 /end MEASUREMENT
/begin MEASUREMENT AION_auto_mode_request_Y.OutBus_get_BCS_info_get_RLWheelSpdVD "" UBYTE AION_auto_mode_request_CM_uint8 0 0 0 1 ECU_ADDRESS 0x002051B0 /end MEASUREMENT
/begin MEASUREMENT AION_auto_mode_request_Y.OutBus_get_BCS_info_get_RRWheelRotatedDirection "" UBYTE AION_auto_mode_request_CM_uint8 0 0 0 1 ECU_ADDRESS 0x002051B1 /end MEASUREMENT
/begin MEASUREMENT AION_auto_mode_request_Y.OutBus_get_BCS_info_get_RRWheelRotatedDirectionVD "" UBYTE AION_auto_mode_request_CM_uint8 0 0 0 1 ECU_ADDRESS 0x002051B2 /end MEASUREMENT
/begin MEASUREMENT AION_auto_mode_request_Y.OutBus_get_BCS_info_get_RRWheelSpd "" FLOAT64_IEEE AION_auto_mode_request_CM_double_km_h 0 0 0 240 ECU_ADDRESS 0x002051B8 /end MEASUREMENT
/begin MEASUREMENT AION_auto_mode_request_Y.OutBus_get_BCS_info_get_RRWheelSpdEdgesSum "" ULONG AION_auto_mode_request_CM_uint32 0 0 0 4095 ECU_ADDRESS 0x0020514C /end MEASUREMENT
/begin MEASUREMENT AION_auto_mode_request_Y.OutBus_get_BCS_info_get_RRWheelSpdEdgesSumVD "" UBYTE AION_auto_mode_request_CM_uint8 0 0 0 1 ECU_ADDRESS 0x00205150 /end MEASUREMENT
/begin MEASUREMENT AION_auto_mode_request_Y.OutBus_get_BCS_info_get_RRWheelSpdVD "" UBYTE AION_auto_mode_request_CM_uint8 0 0 0 1 ECU_ADDRESS 0x002051C0 /end MEASUREMENT
/begin MEASUREMENT AION_auto_mode_request_Y.OutBus_get_BCS_info_get_VDCActiveSt "" UBYTE AION_auto_mode_request_CM_uint8__ 0 0 0 1 ECU_ADDRESS 0x00205122 /end MEASUREMENT
/begin MEASUREMENT AION_auto_mode_request_Y.OutBus_get_BCS_info_get_VDCFaultSt "" UBYTE AION_auto_mode_request_CM_uint8__ 0 0 0 1 ECU_ADDRESS 0x00205123 /end MEASUREMENT
/begin MEASUREMENT AION_auto_mode_request_Y.OutBus_get_BCS_info_get_VehLaltrlAccelOffset "" FLOAT64_IEEE AION_auto_mode_request_CM_double_m_s_2 0 0 -21.593 21.593 ECU_ADDRESS 0x002051E8 /end MEASUREMENT
/begin MEASUREMENT AION_auto_mode_request_Y.OutBus_get_BCS_info_get_VehLongAccelOffset "" FLOAT64_IEEE AION_auto_mode_request_CM_double_m_s_2 0 0 -21.593 21.593 ECU_ADDRESS 0x002051F0 /end MEASUREMENT
/begin MEASUREMENT AION_auto_mode_request_Y.OutBus_get_BCS_info_get_VehSpd "" FLOAT64_IEEE AION_auto_mode_request_CM_double_km_h 0 0 0 240 ECU_ADDRESS 0x00205128 /end MEASUREMENT
/begin MEASUREMENT AION_auto_mode_request_Y.OutBus_get_BCS_info_get_VehSpdVD "" UBYTE AION_auto_mode_request_CM_uint8__ 0 0 0 1 ECU_ADDRESS 0x00205130 /end MEASUREMENT
/begin MEASUREMENT AION_auto_mode_request_Y.OutBus_get_BCS_info_get_VehicleStandStillSt "" UBYTE AION_auto_mode_request_CM_uint8 0 0 0 3 ECU_ADDRESS 0x00205183 /end MEASUREMENT
/begin MEASUREMENT AION_auto_mode_request_Y.OutBus_get_BCS_info_get_YawRate "" FLOAT64_IEEE AION_auto_mode_request_CM_double_rad_s 0 0 -2.0943 1.9047234375 ECU_ADDRESS 0x00205158 /end MEASUREMENT
/begin MEASUREMENT AION_auto_mode_request_Y.OutBus_get_BCS_info_get_YawRateOffset "" FLOAT64_IEEE AION_auto_mode_request_CM_double_rad_s 0 0 -0.13 0.13 ECU_ADDRESS 0x00205160 /end MEASUREMENT
/begin MEASUREMENT AION_auto_mode_request_Y.OutBus_get_BCS_info_get_YawRateSt "" UBYTE AION_auto_mode_request_CM_uint8 0 0 0 1 ECU_ADDRESS 0x00205168 /end MEASUREMENT
/begin MEASUREMENT AION_auto_mode_request_Y.OutBus_get_EPB_info_get_FailSt "" SLONG AION_auto_mode_request_CM_Error_status 0 0 0 1 ECU_ADDRESS 0x002052F4 /end MEASUREMENT
/begin MEASUREMENT AION_auto_mode_request_Y.OutBus_get_EPB_info_get_SwitchSt "" UBYTE AION_auto_mode_request_CM_uint8 0 0 0 3 ECU_ADDRESS 0x002052F8 /end MEASUREMENT
/begin MEASUREMENT AION_auto_mode_request_Y.OutBus_get_EPB_info_get_SwitchStVD "" UBYTE AION_auto_mode_request_CM_uint8 0 0 0 1 ECU_ADDRESS 0x002052F9 /end MEASUREMENT
/begin MEASUREMENT AION_auto_mode_request_Y.OutBus_get_EPB_info_get_SysSt "" UBYTE AION_auto_mode_request_CM_uint8 0 0 0 7 ECU_ADDRESS 0x002052FA /end MEASUREMENT
/begin MEASUREMENT AION_auto_mode_request_Y.OutBus_get_EPS_info_get_SteeringAngle "" FLOAT64_IEEE AION_auto_mode_request_CM_double_deg 0 0 -780 779.9 ECU_ADDRESS 0x00205300 /end MEASUREMENT
/begin MEASUREMENT AION_auto_mode_request_Y.OutBus_get_EPS_info_get_SteeringAngleSpd "" ULONG AION_auto_mode_request_CM_uint32_deg_sec 0 0 0 1016 ECU_ADDRESS 0x00205308 /end MEASUREMENT
/begin MEASUREMENT AION_auto_mode_request_Y.OutBus_get_EPS_info_get_SteeringAngleSpdVD "" UBYTE AION_auto_mode_request_CM_uint8 0 0 0 1 ECU_ADDRESS 0x0020530C /end MEASUREMENT
/begin MEASUREMENT AION_auto_mode_request_Y.OutBus_get_EPS_info_get_SteeringAngleVD "" UBYTE AION_auto_mode_request_CM_uint8 0 0 0 1 ECU_ADDRESS 0x0020530D /end MEASUREMENT
/begin MEASUREMENT AION_auto_mode_request_Y.OutBus_get_EPS_info_get_StrngWhlTorq "" FLOAT64_IEEE AION_auto_mode_request_CM_double_Nm 0 0 -12.5 12.5 ECU_ADDRESS 0x00205310 /end MEASUREMENT
/begin MEASUREMENT AION_auto_mode_request_Y.OutBus_get_EPS_info_get_StrngWhlTorqVD "" UBYTE AION_auto_mode_request_CM_uint8 0 0 0 1 ECU_ADDRESS 0x00205318 /end MEASUREMENT
/begin MEASUREMENT AION_auto_mode_request_Y.OutBus_get_EPS_info_get_ThermalSt "" UBYTE AION_auto_mode_request_CM_uint8 0 0 0 3 ECU_ADDRESS 0x00205319 /end MEASUREMENT
/begin MEASUREMENT AION_auto_mode_request_Y.OutBus_get_EPS_info_get_WarnLamp "" UBYTE AION_auto_mode_request_CM_uint8 0 0 0 1 ECU_ADDRESS 0x0020531A /end MEASUREMENT
/begin MEASUREMENT AION_auto_mode_request_Y.OutBus_get_SCU_info_get_Checksum1 "" ULONG AION_auto_mode_request_CM_uint32__ 0 0 0 255 ECU_ADDRESS 0x00205254 /end MEASUREMENT
/begin MEASUREMENT AION_auto_mode_request_Y.OutBus_get_SCU_info_get_Checksum10 "" ULONG AION_auto_mode_request_CM_uint32 0 0 0 255 ECU_ADDRESS 0x0020525C /end MEASUREMENT
/begin MEASUREMENT AION_auto_mode_request_Y.OutBus_get_SCU_info_get_Checksum11 "" ULONG AION_auto_mode_request_CM_uint32 0 0 0 255 ECU_ADDRESS 0x00205264 /end MEASUREMENT
/begin MEASUREMENT AION_auto_mode_request_Y.OutBus_get_SCU_info_get_Checksum12 "" ULONG AION_auto_mode_request_CM_uint32 0 0 0 255 ECU_ADDRESS 0x0020526C /end MEASUREMENT
/begin MEASUREMENT AION_auto_mode_request_Y.OutBus_get_SCU_info_get_Checksum13 "" ULONG AION_auto_mode_request_CM_uint32 0 0 0 255 ECU_ADDRESS 0x00205274 /end MEASUREMENT
/begin MEASUREMENT AION_auto_mode_request_Y.OutBus_get_SCU_info_get_Checksum16 "" ULONG AION_auto_mode_request_CM_uint32__ 0 0 0 205 ECU_ADDRESS 0x0020529C /end MEASUREMENT
/begin MEASUREMENT AION_auto_mode_request_Y.OutBus_get_SCU_info_get_Checksum17 "" ULONG AION_auto_mode_request_CM_uint32__ 0 0 0 255 ECU_ADDRESS 0x002052A4 /end MEASUREMENT
/begin MEASUREMENT AION_auto_mode_request_Y.OutBus_get_SCU_info_get_Checksum18 "" ULONG AION_auto_mode_request_CM_uint32__ 0 0 0 255 ECU_ADDRESS 0x002052AC /end MEASUREMENT
/begin MEASUREMENT AION_auto_mode_request_Y.OutBus_get_SCU_info_get_Checksum2 "" ULONG AION_auto_mode_request_CM_uint32 0 0 0 255 ECU_ADDRESS 0x002052B4 /end MEASUREMENT
/begin MEASUREMENT AION_auto_mode_request_Y.OutBus_get_SCU_info_get_Checksum3 "" ULONG AION_auto_mode_request_CM_uint32 0 0 0 255 ECU_ADDRESS 0x002052BC /end MEASUREMENT
/begin MEASUREMENT AION_auto_mode_request_Y.OutBus_get_SCU_info_get_Checksum4 "" ULONG AION_auto_mode_request_CM_uint32__ 0 0 0 255 ECU_ADDRESS 0x002052C4 /end MEASUREMENT
/begin MEASUREMENT AION_auto_mode_request_Y.OutBus_get_SCU_info_get_Checksum5 "" ULONG AION_auto_mode_request_CM_uint32__ 0 0 0 255 ECU_ADDRESS 0x002052CC /end MEASUREMENT
/begin MEASUREMENT AION_auto_mode_request_Y.OutBus_get_SCU_info_get_Checksum6 "" ULONG AION_auto_mode_request_CM_uint32 0 0 0 255 ECU_ADDRESS 0x002052D4 /end MEASUREMENT
/begin MEASUREMENT AION_auto_mode_request_Y.OutBus_get_SCU_info_get_Checksum7 "" ULONG AION_auto_mode_request_CM_uint32 0 0 0 255 ECU_ADDRESS 0x002052DC /end MEASUREMENT
/begin MEASUREMENT AION_auto_mode_request_Y.OutBus_get_SCU_info_get_Checksum8 "" ULONG AION_auto_mode_request_CM_uint32 0 0 0 255 ECU_ADDRESS 0x002052E4 /end MEASUREMENT
/begin MEASUREMENT AION_auto_mode_request_Y.OutBus_get_SCU_info_get_Checksum9 "" ULONG AION_auto_mode_request_CM_uint32 0 0 0 255 ECU_ADDRESS 0x002052EC /end MEASUREMENT
/begin MEASUREMENT AION_auto_mode_request_Y.OutBus_get_SCU_info_get_EStopSwSt "" UBYTE AION_auto_mode_request_CM_uint8 0 0 0 1 ECU_ADDRESS 0x0020527C /end MEASUREMENT
/begin MEASUREMENT AION_auto_mode_request_Y.OutBus_get_SCU_info_get_EStopSwStVD "" UBYTE AION_auto_mode_request_CM_uint8 0 0 0 1 ECU_ADDRESS 0x0020527D /end MEASUREMENT
/begin MEASUREMENT AION_auto_mode_request_Y.OutBus_get_SCU_info_get_LatAutoCheckReport "" ULONG AION_auto_mode_request_CM_uint32 0 0 0 15 ECU_ADDRESS 0x00205280 /end MEASUREMENT
/begin MEASUREMENT AION_auto_mode_request_Y.OutBus_get_SCU_info_get_LatCtrlMode "" SLONG AION_auto_mode_request_CM_Control_status 0 0 0 3 ECU_ADDRESS 0x00205284 /end MEASUREMENT
/begin MEASUREMENT AION_auto_mode_request_Y.OutBus_get_SCU_info_get_LatQuitReport "" ULONG AION_auto_mode_request_CM_uint32 0 0 0 255 ECU_ADDRESS 0x00205288 /end MEASUREMENT
/begin MEASUREMENT AION_auto_mode_request_Y.OutBus_get_SCU_info_get_LngAutoCheckIReport "" ULONG AION_auto_mode_request_CM_uint32 0 0 0 65535 ECU_ADDRESS 0x0020528C /end MEASUREMENT
/begin MEASUREMENT AION_auto_mode_request_Y.OutBus_get_SCU_info_get_LngCtrlMode "" SLONG AION_auto_mode_request_CM_Control_status 0 0 0 3 ECU_ADDRESS 0x00205290 /end MEASUREMENT
/begin MEASUREMENT AION_auto_mode_request_Y.OutBus_get_SCU_info_get_LngQuitReport "" ULONG AION_auto_mode_request_CM_uint32 0 0 0 65535 ECU_ADDRESS 0x00205294 /end MEASUREMENT
/begin MEASUREMENT AION_auto_mode_request_Y.OutBus_get_SCU_info_get_MsgCounter1 "" ULONG AION_auto_mode_request_CM_uint32__ 0 0 0 15 ECU_ADDRESS 0x00205258 /end MEASUREMENT
/begin MEASUREMENT AION_auto_mode_request_Y.OutBus_get_SCU_info_get_MsgCounter10 "" ULONG AION_auto_mode_request_CM_uint32 0 0 0 15 ECU_ADDRESS 0x00205260 /end MEASUREMENT
/begin MEASUREMENT AION_auto_mode_request_Y.OutBus_get_SCU_info_get_MsgCounter11 "" ULONG AION_auto_mode_request_CM_uint32 0 0 0 15 ECU_ADDRESS 0x00205268 /end MEASUREMENT
/begin MEASUREMENT AION_auto_mode_request_Y.OutBus_get_SCU_info_get_MsgCounter12 "" ULONG AION_auto_mode_request_CM_uint32 0 0 0 15 ECU_ADDRESS 0x00205270 /end MEASUREMENT
/begin MEASUREMENT AION_auto_mode_request_Y.OutBus_get_SCU_info_get_MsgCounter13 "" ULONG AION_auto_mode_request_CM_uint32 0 0 0 15 ECU_ADDRESS 0x00205278 /end MEASUREMENT
/begin MEASUREMENT AION_auto_mode_request_Y.OutBus_get_SCU_info_get_MsgCounter16 "" ULONG AION_auto_mode_request_CM_uint32__ 0 0 0 15 ECU_ADDRESS 0x002052A0 /end MEASUREMENT
/begin MEASUREMENT AION_auto_mode_request_Y.OutBus_get_SCU_info_get_MsgCounter17 "" ULONG AION_auto_mode_request_CM_uint32__ 0 0 0 15 ECU_ADDRESS 0x002052A8 /end MEASUREMENT
/begin MEASUREMENT AION_auto_mode_request_Y.OutBus_get_SCU_info_get_MsgCounter18 "" ULONG AION_auto_mode_request_CM_uint32__ 0 0 0 15 ECU_ADDRESS 0x002052B0 /end MEASUREMENT
/begin MEASUREMENT AION_auto_mode_request_Y.OutBus_get_SCU_info_get_MsgCounter2 "" ULONG AION_auto_mode_request_CM_uint32 0 0 0 15 ECU_ADDRESS 0x002052B8 /end MEASUREMENT
/begin MEASUREMENT AION_auto_mode_request_Y.OutBus_get_SCU_info_get_MsgCounter3 "" ULONG AION_auto_mode_request_CM_uint32 0 0 0 15 ECU_ADDRESS 0x002052C0 /end MEASUREMENT
/begin MEASUREMENT AION_auto_mode_request_Y.OutBus_get_SCU_info_get_MsgCounter4 "" ULONG AION_auto_mode_request_CM_uint32__ 0 0 0 15 ECU_ADDRESS 0x002052C8 /end MEASUREMENT
/begin MEASUREMENT AION_auto_mode_request_Y.OutBus_get_SCU_info_get_MsgCounter5 "" ULONG AION_auto_mode_request_CM_uint32 0 0 0 15 ECU_ADDRESS 0x002052D0 /end MEASUREMENT
/begin MEASUREMENT AION_auto_mode_request_Y.OutBus_get_SCU_info_get_MsgCounter6 "" ULONG AION_auto_mode_request_CM_uint32 0 0 0 15 ECU_ADDRESS 0x002052D8 /end MEASUREMENT
/begin MEASUREMENT AION_auto_mode_request_Y.OutBus_get_SCU_info_get_MsgCounter7 "" ULONG AION_auto_mode_request_CM_uint32 0 0 0 15 ECU_ADDRESS 0x002052E0 /end MEASUREMENT
/begin MEASUREMENT AION_auto_mode_request_Y.OutBus_get_SCU_info_get_MsgCounter8 "" ULONG AION_auto_mode_request_CM_uint32 0 0 0 15 ECU_ADDRESS 0x002052E8 /end MEASUREMENT
/begin MEASUREMENT AION_auto_mode_request_Y.OutBus_get_SCU_info_get_MsgCounter9 "" ULONG AION_auto_mode_request_CM_uint32 0 0 0 15 ECU_ADDRESS 0x002052F0 /end MEASUREMENT
/begin MEASUREMENT AION_auto_mode_request_Y.OutBus_get_SCU_info_get_StrngWhlIntv "" UBYTE AION_auto_mode_request_CM_uint8 0 0 0 1 ECU_ADDRESS 0x00205298 /end MEASUREMENT
/begin MEASUREMENT AION_auto_mode_request_Y.OutBus_get_SRS_info_get_DriverSeatBeltSt "" UBYTE AION_auto_mode_request_CM_uint8 0 0 0 3 ECU_ADDRESS 0x002052FB /end MEASUREMENT
/begin MEASUREMENT AION_auto_mode_request_Y.OutBus_get_SRS_info_get_PsngrSeatBeltSt "" UBYTE AION_auto_mode_request_CM_uint8 0 0 0 3 ECU_ADDRESS 0x002052FC /end MEASUREMENT
/begin MEASUREMENT AION_auto_mode_request_Y.OutBus_get_VCU_info_get_ACCButtInfo "" ULONG AION_auto_mode_request_CM_uint32 0 0 0 255 ECU_ADDRESS 0x00205224 /end MEASUREMENT
/begin MEASUREMENT AION_auto_mode_request_Y.OutBus_get_VCU_info_get_ACCMaxRecpDecel "" FLOAT64_IEEE AION_auto_mode_request_CM_double_m_s2 0 0 -5 7.75 ECU_ADDRESS 0x00205210 /end MEASUREMENT
/begin MEASUREMENT AION_auto_mode_request_Y.OutBus_get_VCU_info_get_ACCMaxRecpDecelVD "" UBYTE AION_auto_mode_request_CM_uint8 0 0 0 1 ECU_ADDRESS 0x00205218 /end MEASUREMENT
/begin MEASUREMENT AION_auto_mode_request_Y.OutBus_get_VCU_info_get_AccElecECFail "" UBYTE AION_auto_mode_request_CM_uint8__ 0 0 0 1 ECU_ADDRESS 0x00205228 /end MEASUREMENT
/begin MEASUREMENT AION_auto_mode_request_Y.OutBus_get_VCU_info_get_ActRecpTorq "" ULONG AION_auto_mode_request_CM_uint32_Nm 0 0 0 2000 ECU_ADDRESS 0x00205204 /end MEASUREMENT
/begin MEASUREMENT AION_auto_mode_request_Y.OutBus_get_VCU_info_get_ActRecpTorqSt "" UBYTE AION_auto_mode_request_CM_uint8 0 0 0 3 ECU_ADDRESS 0x00205208 /end MEASUREMENT
/begin MEASUREMENT AION_auto_mode_request_Y.OutBus_get_VCU_info_get_ActVehWheelTorq "" ULONG AION_auto_mode_request_CM_uint32_Nm 0 0 0 10000 ECU_ADDRESS 0x0020521C /end MEASUREMENT
/begin MEASUREMENT AION_auto_mode_request_Y.OutBus_get_VCU_info_get_BrkPedalSt "" UBYTE AION_auto_mode_request_CM_uint8 0 0 0 1 ECU_ADDRESS 0x00205240 /end MEASUREMENT
/begin MEASUREMENT AION_auto_mode_request_Y.OutBus_get_VCU_info_get_BrkPedalStVD "" UBYTE AION_auto_mode_request_CM_uint8 0 0 0 1 ECU_ADDRESS 0x00205241 /end MEASUREMENT
/begin MEASUREMENT AION_auto_mode_request_Y.OutBus_get_VCU_info_get_CrntGearLvl "" UBYTE AION_auto_mode_request_CM_uint8 0 0 0 7 ECU_ADDRESS 0x00205209 /end MEASUREMENT
/begin MEASUREMENT AION_auto_mode_request_Y.OutBus_get_VCU_info_get_CrntGearLvlVD "" UBYTE AION_auto_mode_request_CM_uint8 0 0 0 1 ECU_ADDRESS 0x0020520A /end MEASUREMENT
/begin MEASUREMENT AION_auto_mode_request_Y.OutBus_get_VCU_info_get_GasPedalActPst "" FLOAT64_IEEE AION_auto_mode_request_CM_double__ 0 0 0 99.96 ECU_ADDRESS 0x00205230 /end MEASUREMENT
/begin MEASUREMENT AION_auto_mode_request_Y.OutBus_get_VCU_info_get_GasPedalActPstVD "" UBYTE AION_auto_mode_request_CM_uint8 0 0 0 1 ECU_ADDRESS 0x00205238 /end MEASUREMENT
/begin MEASUREMENT AION_auto_mode_request_Y.OutBus_get_VCU_info_get_GasPedalVirtualPst "" FLOAT64_IEEE AION_auto_mode_request_CM_double__ 0 0 0 99.96 ECU_ADDRESS 0x00205248 /end MEASUREMENT
/begin MEASUREMENT AION_auto_mode_request_Y.OutBus_get_VCU_info_get_GasPedalVirtualPstVD "" UBYTE AION_auto_mode_request_CM_uint8 0 0 0 1 ECU_ADDRESS 0x00205250 /end MEASUREMENT
/begin MEASUREMENT AION_auto_mode_request_Y.OutBus_get_VCU_info_get_GearLeverIntv "" UBYTE AION_auto_mode_request_CM_uint8 0 0 0 1 ECU_ADDRESS 0x002051F8 /end MEASUREMENT
/begin MEASUREMENT AION_auto_mode_request_Y.OutBus_get_VCU_info_get_LateralAssistBtnInfo "" UBYTE AION_auto_mode_request_CM_uint8 0 0 0 1 ECU_ADDRESS 0x00205220 /end MEASUREMENT
/begin MEASUREMENT AION_auto_mode_request_Y.OutBus_get_VCU_info_get_LateralAssistBtnInfoVD "" UBYTE AION_auto_mode_request_CM_uint8 0 0 0 1 ECU_ADDRESS 0x00205221 /end MEASUREMENT
/begin MEASUREMENT AION_auto_mode_request_Y.OutBus_get_VCU_info_get_VehDrvMod "" UBYTE AION_auto_mode_request_CM_uint8__ 0 0 0 7 ECU_ADDRESS 0x002051F9 /end MEASUREMENT
/begin MEASUREMENT AION_auto_mode_request_Y.OutBus_get_VCU_info_get_VehRdySt "" SLONG AION_auto_mode_request_CM_Ready_status__ 0 0 0 1 ECU_ADDRESS 0x002051FC /end MEASUREMENT
/begin MEASUREMENT AION_auto_mode_request_Y.OutBus_get_VCU_info_get_VehRng "" ULONG AION_auto_mode_request_CM_uint32_km 0 0 0 1000 ECU_ADDRESS 0x00205200 /end MEASUREMENT
/begin MEASUREMENT AION_auto_mode_request_Y.OutBus_get_VCU_info_get_VehWheelTorqMax "" ULONG AION_auto_mode_request_CM_uint32_Nm 0 0 0 10000 ECU_ADDRESS 0x0020523C /end MEASUREMENT
/begin MEASUREMENT AION_auto_mode_request_Y.OutBus_set_ADCU_info_set_BeamReq "" SLONG AION_auto_mode_request_CM_Beam_request__ 0 0 0 3 ECU_ADDRESS 0x00205110 /end MEASUREMENT
/begin MEASUREMENT AION_auto_mode_request_Y.OutBus_set_ADCU_info_set_BodyCtrlReq "" SLONG AION_auto_mode_request_CM_Enable_request__ 0 0 0 1 ECU_ADDRESS 0x00205114 /end MEASUREMENT
/begin MEASUREMENT AION_auto_mode_request_Y.OutBus_set_ADCU_info_set_Checksum1 "" ULONG AION_auto_mode_request_CM_uint32 0 0 0 255 ECU_ADDRESS 0x002050F8 /end MEASUREMENT
/begin MEASUREMENT AION_auto_mode_request_Y.OutBus_set_ADCU_info_set_Checksum2 "" ULONG AION_auto_mode_request_CM_uint32 0 0 0 255 ECU_ADDRESS 0x00205100 /end MEASUREMENT
/begin MEASUREMENT AION_auto_mode_request_Y.OutBus_set_ADCU_info_set_Checksum3 "" ULONG AION_auto_mode_request_CM_uint32__ 0 0 0 255 ECU_ADDRESS 0x00205108 /end MEASUREMENT
/begin MEASUREMENT AION_auto_mode_request_Y.OutBus_set_ADCU_info_set_HornRingReq "" SLONG AION_auto_mode_request_CM_Active_request__ 0 0 0 1 ECU_ADDRESS 0x00205118 /end MEASUREMENT
/begin MEASUREMENT AION_auto_mode_request_Y.OutBus_set_ADCU_info_set_MsgCounter1 "" ULONG AION_auto_mode_request_CM_uint32 0 0 0 15 ECU_ADDRESS 0x002050FC /end MEASUREMENT
/begin MEASUREMENT AION_auto_mode_request_Y.OutBus_set_ADCU_info_set_MsgCounter2 "" ULONG AION_auto_mode_request_CM_uint32 0 0 0 15 ECU_ADDRESS 0x00205104 /end MEASUREMENT
/begin MEASUREMENT AION_auto_mode_request_Y.OutBus_set_ADCU_info_set_MsgCounter3 "" ULONG AION_auto_mode_request_CM_uint32__ 0 0 0 15 ECU_ADDRESS 0x0020510C /end MEASUREMENT
/begin MEASUREMENT AION_auto_mode_request_Y.OutBus_set_ADCU_info_set_TurnLightReq "" SLONG AION_auto_mode_request_CM_Light_request__ 0 0 0 3 ECU_ADDRESS 0x0020511C /end MEASUREMENT
/begin MEASUREMENT AION_auto_mode_request_Y.OutBus_set_lateral_control_info_set_LatCtrlReq "" SLONG AION_auto_mode_request_CM_Control_request 0 0 0 3 ECU_ADDRESS 0x002050C0 /end MEASUREMENT
/begin MEASUREMENT AION_auto_mode_request_Y.OutBus_set_lateral_control_info_set_SteerAngReq "" FLOAT64_IEEE AION_auto_mode_request_CM_double 0 0 -1.7E+308 1.7E+308 ECU_ADDRESS 0x002050D0 /end MEASUREMENT
/begin MEASUREMENT AION_auto_mode_request_Y.OutBus_set_lateral_control_info_set_SteerAngSpdLimt "" FLOAT64_IEEE AION_auto_mode_request_CM_double 0 0 -1.7E+308 1.7E+308 ECU_ADDRESS 0x002050D8 /end MEASUREMENT
/begin MEASUREMENT AION_auto_mode_request_Y.OutBus_set_lateral_control_info_set_SteerWhlTorqReq "" FLOAT64_IEEE AION_auto_mode_request_CM_double 0 0 -1.7E+308 1.7E+308 ECU_ADDRESS 0x002050C8 /end MEASUREMENT
/begin MEASUREMENT AION_auto_mode_request_Y.OutBus_set_longitudinal_control_info_set_AutoTrqWhlReq "" SLONG AION_auto_mode_request_CM_int32 0 0 0 [] ECU_ADDRESS 0x002050E4 /end MEASUREMENT
/begin MEASUREMENT AION_auto_mode_request_Y.OutBus_set_longitudinal_control_info_set_BrakeReq "" FLOAT64_IEEE AION_auto_mode_request_CM_double 0 0 0 [] ECU_ADDRESS 0x002050E8 /end MEASUREMENT
/begin MEASUREMENT AION_auto_mode_request_Y.OutBus_set_longitudinal_control_info_set_GearLvlReq "" SLONG AION_auto_mode_request_CM_AION_gear 0 0 0 7 ECU_ADDRESS 0x002050F0 /end MEASUREMENT
/begin MEASUREMENT AION_auto_mode_request_Y.OutBus_set_longitudinal_control_info_set_GearLvlReqVD "" SLONG AION_auto_mode_request_CM_Validation_status 0 0 0 1 ECU_ADDRESS 0x002050F4 /end MEASUREMENT
/begin MEASUREMENT AION_auto_mode_request_Y.OutBus_set_longitudinal_control_info_set_LngCtrlReq "" SLONG AION_auto_mode_request_CM_Control_request 0 0 0 3 ECU_ADDRESS 0x002050E0 /end MEASUREMENT
/begin COMPU_METHOD AION_auto_mode_request_CM_AION_gear "" TAB_VERB "%0.6" "" COMPU_TAB_REF VTAB_FOR_AION_auto_mode_request_CM_AION_gear /end COMPU_METHOD
/begin COMPU_VTAB VTAB_FOR_AION_auto_mode_request_CM_AION_gear "Enumerated data type: AION_gear" TAB_VERB 8 0 "NoRequest" 1 "P" 2 "R" 3 "N" 4 "D" 5 "Reserved_gear" 6 "Reserved1_gear" 7 "Reserved2_gear" /end COMPU_VTAB
/begin COMPU_METHOD AION_auto_mode_request_CM_Active_request__ "" TAB_VERB "%0.6" "-" COMPU_TAB_REF VTAB_FOR_AION_auto_mode_request_CM_Active_request__ /end COMPU_METHOD
/begin COMPU_VTAB VTAB_FOR_AION_auto_mode_request_CM_Active_request__ "Enumerated data type: Active_request" TAB_VERB 2 0 "NotActiveRequest" 1 "ActiveRequest" /end COMPU_VTAB
/begin COMPU_METHOD AION_auto_mode_request_CM_Available_status "" TAB_VERB "%0.6" "" COMPU_TAB_REF VTAB_FOR_AION_auto_mode_request_CM_Available_status /end COMPU_METHOD
/begin COMPU_VTAB VTAB_FOR_AION_auto_mode_request_CM_Available_status "Enumerated data type: Available_status" TAB_VERB 2 0 "NotAvailable" 1 "Available" /end COMPU_VTAB
/begin COMPU_METHOD AION_auto_mode_request_CM_Beam_request__ "" TAB_VERB "%0.6" "-" COMPU_TAB_REF VTAB_FOR_AION_auto_mode_request_CM_Beam_request__ /end COMPU_METHOD
/begin COMPU_VTAB VTAB_FOR_AION_auto_mode_request_CM_Beam_request__ "Enumerated data type: Beam_request" TAB_VERB 4 0 "NoBeamRequest" 1 "LowBeam" 2 "HighBeam" 3 "BeamReserved" /end COMPU_VTAB
/begin COMPU_METHOD AION_auto_mode_request_CM_Control_request "" TAB_VERB "%0.6" "" COMPU_TAB_REF VTAB_FOR_AION_auto_mode_request_CM_Control_request /end COMPU_METHOD
/begin COMPU_VTAB VTAB_FOR_AION_auto_mode_request_CM_Control_request "Enumerated data type: Control_request" TAB_VERB 4 0 "Manual" 1 "Auto" 2 "Reserved" 3 "Reserved1" /end COMPU_VTAB
/begin COMPU_METHOD AION_auto_mode_request_CM_Control_status "" TAB_VERB "%0.6" "" COMPU_TAB_REF VTAB_FOR_AION_auto_mode_request_CM_Control_status /end COMPU_METHOD
/begin COMPU_VTAB VTAB_FOR_AION_auto_mode_request_CM_Control_status "Enumerated data type: Control_status" TAB_VERB 4 0 "ManualStatus" 1 "QuitStatus" 2 "AutoStatus" 3 "FaultStatus" /end COMPU_VTAB
/begin COMPU_METHOD AION_auto_mode_request_CM_Enable_request__ "" TAB_VERB "%0.6" "-" COMPU_TAB_REF VTAB_FOR_AION_auto_mode_request_CM_Enable_request__ /end COMPU_METHOD
/begin COMPU_VTAB VTAB_FOR_AION_auto_mode_request_CM_Enable_request__ "Enumerated data type: Enable_request" TAB_VERB 2 0 "Disable" 1 "Enable" /end COMPU_VTAB
/begin COMPU_METHOD AION_auto_mode_request_CM_Error_status "" TAB_VERB "%0.6" "" COMPU_TAB_REF VTAB_FOR_AION_auto_mode_request_CM_Error_status /end COMPU_METHOD
/begin COMPU_VTAB VTAB_FOR_AION_auto_mode_request_CM_Error_status "Enumerated data type: Error_status" TAB_VERB 2 0 "NoError" 1 "Error" /end COMPU_VTAB
/begin COMPU_METHOD AION_auto_mode_request_CM_Fault_status "" TAB_VERB "%0.6" "" COMPU_TAB_REF VTAB_FOR_AION_auto_mode_request_CM_Fault_status /end COMPU_METHOD
/begin COMPU_VTAB VTAB_FOR_AION_auto_mode_request_CM_Fault_status "Enumerated data type: Fault_status" TAB_VERB 2 0 "NotFault" 1 "Fault" /end COMPU_VTAB
/begin COMPU_METHOD AION_auto_mode_request_CM_Light_request__ "" TAB_VERB "%0.6" "-" COMPU_TAB_REF VTAB_FOR_AION_auto_mode_request_CM_Light_request__ /end COMPU_METHOD
/begin COMPU_VTAB VTAB_FOR_AION_auto_mode_request_CM_Light_request__ "Enumerated data type: Light_request" TAB_VERB 4 0 "NoLightRequest" 1 "TurnLeftLight" 2 "TurnRightLight" 3 "EmergencyLight" /end COMPU_VTAB
/begin COMPU_METHOD AION_auto_mode_request_CM_Ready_status__ "" TAB_VERB "%0.6" "-" COMPU_TAB_REF VTAB_FOR_AION_auto_mode_request_CM_Ready_status__ /end COMPU_METHOD
/begin COMPU_VTAB VTAB_FOR_AION_auto_mode_request_CM_Ready_status__ "Enumerated data type: Ready_status" TAB_VERB 2 0 "NotReady" 1 "Ready" /end COMPU_VTAB
/begin COMPU_METHOD AION_auto_mode_request_CM_Validation_status "" TAB_VERB "%0.6" "" COMPU_TAB_REF VTAB_FOR_AION_auto_mode_request_CM_Validation_status /end COMPU_METHOD
/begin COMPU_VTAB VTAB_FOR_AION_auto_mode_request_CM_Validation_status "Enumerated data type: Validation_status" TAB_VERB 2 0 "Invalid" 1 "Valid" /end COMPU_VTAB
/begin COMPU_METHOD AION_auto_mode_request_CM_double "" IDENTICAL "%15.10" "" /end COMPU_METHOD
/begin COMPU_METHOD AION_auto_mode_request_CM_double_Nm "" IDENTICAL "%15.10" "Nm" /end COMPU_METHOD
/begin COMPU_METHOD AION_auto_mode_request_CM_double__ "" IDENTICAL "%15.10" "%" /end COMPU_METHOD
/begin COMPU_METHOD AION_auto_mode_request_CM_double_bar "" IDENTICAL "%15.10" "bar" /end COMPU_METHOD
/begin COMPU_METHOD AION_auto_mode_request_CM_double_deg "" IDENTICAL "%15.10" "deg" /end COMPU_METHOD
/begin COMPU_METHOD AION_auto_mode_request_CM_double_km_h "" IDENTICAL "%15.10" "km/h" /end COMPU_METHOD
/begin COMPU_METHOD AION_auto_mode_request_CM_double_m_s2 "" IDENTICAL "%15.10" "m/s2" /end COMPU_METHOD
/begin COMPU_METHOD AION_auto_mode_request_CM_double_m_s_2 "" IDENTICAL "%15.10" "m/s^2" /end COMPU_METHOD
/begin COMPU_METHOD AION_auto_mode_request_CM_double_rad_s "" IDENTICAL "%15.10" "rad/s" /end COMPU_METHOD
/begin COMPU_METHOD AION_auto_mode_request_CM_int32 "" IDENTICAL "%10.0" "" /end COMPU_METHOD
/begin COMPU_METHOD AION_auto_mode_request_CM_uint32 "" IDENTICAL "%10.0" "" /end COMPU_METHOD
/begin COMPU_METHOD AION_auto_mode_request_CM_uint32_Nm "" IDENTICAL "%10.0" "Nm" /end COMPU_METHOD
/begin COMPU_METHOD AION_auto_mode_request_CM_uint32__ "" IDENTICAL "%10.0" "-" /end COMPU_METHOD
/begin COMPU_METHOD AION_auto_mode_request_CM_uint32_deg_sec "" IDENTICAL "%10.0" "deg/sec" /end COMPU_METHOD
/begin COMPU_METHOD AION_auto_mode_request_CM_uint32_km "" IDENTICAL "%10.0" "km" /end COMPU_METHOD
/begin COMPU_METHOD AION_auto_mode_request_CM_uint8 "" IDENTICAL "%3.0" "" /end COMPU_METHOD
/begin COMPU_METHOD AION_auto_mode_request_CM_uint8__ "" IDENTICAL "%3.0" "-" /end COMPU_METHOD
/begin RECORD_LAYOUT Scalar_FLOAT64_IEEE FNC_VALUES 1 FLOAT64_IEEE COLUMN_DIR DIRECT /end RECORD_LAYOUT
/begin RECORD_LAYOUT Scalar_SLONG FNC_VALUES 1 SLONG COLUMN_DIR DIRECT /end RECORD_LAYOUT
/begin RECORD_LAYOUT Scalar_UBYTE FNC_VALUES 1 UBYTE COLUMN_DIR DIRECT /end RECORD_LAYOUT
/begin RECORD_LAYOUT Scalar_ULONG FNC_VALUES 1 ULONG COLUMN_DIR DIRECT /end RECORD_LAYOUT
/begin GROUP AION_auto_mode_request "AION_auto_mode_request" ROOT /end GROUP
/end MODULE
/end PROJECT
