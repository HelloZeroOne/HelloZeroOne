/******************************************************************************
* ASAP2 file: AION_request_fail_analysis.a2l
* Code generation for model "AION_request_fail_analysis".
* Model version : 1.20
* Simulink Coder version : 10.3 R2021a
* C source code generated on : Sun May 22 14:06:28 2022
* Target selection: slrealtime.tlc
* Embedded hardware selection: Intel->x86-64 (Linux 64)
* Code generation objectives: Unspecified
* Validation result: Not run
* (add additional file header information here)
******************************************************************************/ ASAP2_VERSION 1 71
/begin PROJECT ProjectName "Project Comment Goes Here"
/begin HEADER "Header Comments go here" /end HEADER
/begin MODULE ModuleName "Module Comment Goes Here"
/begin IF_DATA XCP
 /begin PROTOCOL_LAYER 0x0100 0x03E8 0x00C8 0x0000 0x0000 0x0000 0x0000 0x0000 0xFC 0x0578 BYTE_ORDER_MSB_LAST ADDRESS_GRANULARITY_BYTE OPTIONAL_CMD ALLOC_ODT_ENTRY OPTIONAL_CMD ALLOC_ODT OPTIONAL_CMD ALLOC_DAQ OPTIONAL_CMD FREE_DAQ OPTIONAL_CMD GET_DAQ_RESOLUTION_INFO OPTIONAL_CMD GET_DAQ_PROCESSOR_INFO OPTIONAL_CMD START_STOP_SYNCH OPTIONAL_CMD START_STOP_DAQ_LIST OPTIONAL_CMD SET_DAQ_LIST_MODE OPTIONAL_CMD WRITE_DAQ OPTIONAL_CMD SET_DAQ_PTR OPTIONAL_CMD GET_CAL_PAGE OPTIONAL_CMD SET_CAL_PAGE OPTIONAL_CMD COPY_CAL_PAGE OPTIONAL_CMD SHORT_DOWNLOAD OPTIONAL_CMD DOWNLOAD_MAX OPTIONAL_CMD DOWNLOAD OPTIONAL_CMD SHORT_UPLOAD OPTIONAL_CMD UPLOAD OPTIONAL_CMD SET_MTA /end PROTOCOL_LAYER
 /begin DAQ DYNAMIC 0x0000 0x0080 0x00 OPTIMISATION_TYPE_DEFAULT ADDRESS_EXTENSION_FREE IDENTIFICATION_FIELD_TYPE_RELATIVE_WORD_ALIGNED GRANULARITY_ODT_ENTRY_SIZE_DAQ_BYTE 0xFF OVERLOAD_INDICATION_PID PRESCALER_SUPPORTED /begin STIM GRANULARITY_ODT_ENTRY_SIZE_STIM_BYTE 0xFF /end STIM /begin TIMESTAMP_SUPPORTED 0x0001 SIZE_DWORD UNIT_1US TIMESTAMP_FIXED /end TIMESTAMP_SUPPORTED /begin EVENT "200 ms" "200 ms" 0x0000 DAQ 0xFF 0x02 0x08 0x00 /end EVENT /end DAQ
 /begin XCP_ON_UDP_IP 0x0100 0x15B3 ADDRESS "192.168.7.1" /end XCP_ON_UDP_IP
/end IF_DATA
/begin MOD_PAR "MOD PAR Comment Goes Here" /end MOD_PAR
/begin MOD_COMMON "Mod Common Comment Here" BYTE_ORDER MSB_LAST ALIGNMENT_BYTE 1 ALIGNMENT_WORD 2 ALIGNMENT_LONG 8 ALIGNMENT_FLOAT32_IEEE 4 ALIGNMENT_FLOAT64_IEEE 8 ALIGNMENT_INT64 4 /end MOD_COMMON
/begin MEASUREMENT AION_request_fail_analysis_DW.request_fail_count "" FLOAT64_IEEE AION_request_fail_analysis_CM_double 0 0 -1.7E+308 1.7E+308 ECU_ADDRESS 0x00203320 /end MEASUREMENT
/begin MEASUREMENT AION_request_fail_analysis_DW.request_fail_count_b "" FLOAT64_IEEE AION_request_fail_analysis_CM_double 0 0 -1.7E+308 1.7E+308 ECU_ADDRESS 0x00203328 /end MEASUREMENT
/begin MEASUREMENT AION_request_fail_analysis_U.InBus_get_BCM_info_get_CtrlAvailable "" SLONG AION_request_fail_analysis_CM_Available_status 0 0 0 1 ECU_ADDRESS 0x0020330C /end MEASUREMENT
/begin MEASUREMENT AION_request_fail_analysis_U.InBus_get_BCM_info_get_DriverDoorAjarSt "" UBYTE AION_request_fail_analysis_CM_uint8 0 0 0 1 ECU_ADDRESS 0x00203310 /end MEASUREMENT
/begin MEASUREMENT AION_request_fail_analysis_U.InBus_get_BCM_info_get_FrontFogLampSt "" UBYTE AION_request_fail_analysis_CM_uint8 0 0 0 1 ECU_ADDRESS 0x00203311 /end MEASUREMENT
/begin MEASUREMENT AION_request_fail_analysis_U.InBus_get_BCM_info_get_FrontWiperSt "" UBYTE AION_request_fail_analysis_CM_uint8 0 0 0 3 ECU_ADDRESS 0x00203312 /end MEASUREMENT
/begin MEASUREMENT AION_request_fail_analysis_U.InBus_get_BCM_info_get_HazardLampSt "" UBYTE AION_request_fail_analysis_CM_uint8 0 0 0 1 ECU_ADDRESS 0x00203313 /end MEASUREMENT
/begin MEASUREMENT AION_request_fail_analysis_U.InBus_get_BCM_info_get_HighBeamSt "" UBYTE AION_request_fail_analysis_CM_uint8 0 0 0 1 ECU_ADDRESS 0x00203314 /end MEASUREMENT
/begin MEASUREMENT AION_request_fail_analysis_U.InBus_get_BCM_info_get_HornSt "" UBYTE AION_request_fail_analysis_CM_uint8 0 0 0 1 ECU_ADDRESS 0x00203315 /end MEASUREMENT
/begin MEASUREMENT AION_request_fail_analysis_U.InBus_get_BCM_info_get_KeySt "" UBYTE AION_request_fail_analysis_CM_uint8 0 0 0 3 ECU_ADDRESS 0x00203316 /end MEASUREMENT
/begin MEASUREMENT AION_request_fail_analysis_U.InBus_get_BCM_info_get_LeftTurnLampFaultSt "" UBYTE AION_request_fail_analysis_CM_uint8 0 0 0 1 ECU_ADDRESS 0x00203317 /end MEASUREMENT
/begin MEASUREMENT AION_request_fail_analysis_U.InBus_get_BCM_info_get_LeftTurnLampSt "" UBYTE AION_request_fail_analysis_CM_uint8 0 0 0 1 ECU_ADDRESS 0x00203318 /end MEASUREMENT
/begin MEASUREMENT AION_request_fail_analysis_U.InBus_get_BCM_info_get_LowBeamSt "" UBYTE AION_request_fail_analysis_CM_uint8 0 0 0 1 ECU_ADDRESS 0x00203319 /end MEASUREMENT
/begin MEASUREMENT AION_request_fail_analysis_U.InBus_get_BCM_info_get_PsngrDoorAjarSt "" UBYTE AION_request_fail_analysis_CM_uint8 0 0 0 1 ECU_ADDRESS 0x0020331A /end MEASUREMENT
/begin MEASUREMENT AION_request_fail_analysis_U.InBus_get_BCM_info_get_RLDoorAjarSt "" UBYTE AION_request_fail_analysis_CM_uint8 0 0 0 1 ECU_ADDRESS 0x0020331B /end MEASUREMENT
/begin MEASUREMENT AION_request_fail_analysis_U.InBus_get_BCM_info_get_RRDoorAjarSt "" UBYTE AION_request_fail_analysis_CM_uint8 0 0 0 1 ECU_ADDRESS 0x0020331C /end MEASUREMENT
/begin MEASUREMENT AION_request_fail_analysis_U.InBus_get_BCM_info_get_RearFogLampSt "" UBYTE AION_request_fail_analysis_CM_uint8 0 0 0 1 ECU_ADDRESS 0x0020331D /end MEASUREMENT
/begin MEASUREMENT AION_request_fail_analysis_U.InBus_get_BCM_info_get_RightTurnLampFaultSt "" UBYTE AION_request_fail_analysis_CM_uint8 0 0 0 1 ECU_ADDRESS 0x0020331E /end MEASUREMENT
/begin MEASUREMENT AION_request_fail_analysis_U.InBus_get_BCM_info_get_RightTurnLampSt "" UBYTE AION_request_fail_analysis_CM_uint8 0 0 0 1 ECU_ADDRESS 0x0020331F /end MEASUREMENT
/begin MEASUREMENT AION_request_fail_analysis_U.InBus_get_BCS_info_get_ABSActiveSt "" UBYTE AION_request_fail_analysis_CM_uint8__ 0 0 0 1 ECU_ADDRESS 0x00203114 /end MEASUREMENT
/begin MEASUREMENT AION_request_fail_analysis_U.InBus_get_BCS_info_get_ABSFaultSt "" UBYTE AION_request_fail_analysis_CM_uint8__ 0 0 0 1 ECU_ADDRESS 0x00203115 /end MEASUREMENT
/begin MEASUREMENT AION_request_fail_analysis_U.InBus_get_BCS_info_get_AEBActive "" UBYTE AION_request_fail_analysis_CM_uint8 0 0 0 1 ECU_ADDRESS 0x0020315B /end MEASUREMENT
/begin MEASUREMENT AION_request_fail_analysis_U.InBus_get_BCS_info_get_AEBAvailable "" UBYTE AION_request_fail_analysis_CM_uint8 0 0 0 1 ECU_ADDRESS 0x0020315C /end MEASUREMENT
/begin MEASUREMENT AION_request_fail_analysis_U.InBus_get_BCS_info_get_ActVehLaltrlAccel "" FLOAT64_IEEE AION_request_fail_analysis_CM_double_m_s_2 0 0 -21.593 21.593 ECU_ADDRESS 0x002031B8 /end MEASUREMENT
/begin MEASUREMENT AION_request_fail_analysis_U.InBus_get_BCS_info_get_ActVehLaltrlAccelVD "" UBYTE AION_request_fail_analysis_CM_uint8 0 0 0 1 ECU_ADDRESS 0x002031C0 /end MEASUREMENT
/begin MEASUREMENT AION_request_fail_analysis_U.InBus_get_BCS_info_get_ActVehLongAccel "" FLOAT64_IEEE AION_request_fail_analysis_CM_double_m_s_2 0 0 -21.593 21.593 ECU_ADDRESS 0x002031C8 /end MEASUREMENT
/begin MEASUREMENT AION_request_fail_analysis_U.InBus_get_BCS_info_get_ActVehLongAccelVD "" UBYTE AION_request_fail_analysis_CM_uint8 0 0 0 1 ECU_ADDRESS 0x002031D0 /end MEASUREMENT
/begin MEASUREMENT AION_request_fail_analysis_U.InBus_get_BCS_info_get_CDDActive "" UBYTE AION_request_fail_analysis_CM_uint8 0 0 0 1 ECU_ADDRESS 0x0020315D /end MEASUREMENT
/begin MEASUREMENT AION_request_fail_analysis_U.InBus_get_BCS_info_get_CDDAvailable "" UBYTE AION_request_fail_analysis_CM_uint8 0 0 0 1 ECU_ADDRESS 0x0020315E /end MEASUREMENT
/begin MEASUREMENT AION_request_fail_analysis_U.InBus_get_BCS_info_get_CDDFail "" UBYTE AION_request_fail_analysis_CM_uint8 0 0 0 1 ECU_ADDRESS 0x0020315F /end MEASUREMENT
/begin MEASUREMENT AION_request_fail_analysis_U.InBus_get_BCS_info_get_FLWheelRotatedDirection "" UBYTE AION_request_fail_analysis_CM_uint8 0 0 0 1 ECU_ADDRESS 0x00203174 /end MEASUREMENT
/begin MEASUREMENT AION_request_fail_analysis_U.InBus_get_BCS_info_get_FLWheelRotatedDirectionVD "" UBYTE AION_request_fail_analysis_CM_uint8 0 0 0 1 ECU_ADDRESS 0x00203175 /end MEASUREMENT
/begin MEASUREMENT AION_request_fail_analysis_U.InBus_get_BCS_info_get_FLWheelSpd "" FLOAT64_IEEE AION_request_fail_analysis_CM_double_km_h 0 0 0 240 ECU_ADDRESS 0x00203178 /end MEASUREMENT
/begin MEASUREMENT AION_request_fail_analysis_U.InBus_get_BCS_info_get_FLWheelSpdEdgesSum "" ULONG AION_request_fail_analysis_CM_uint32 0 0 0 4095 ECU_ADDRESS 0x00203124 /end MEASUREMENT
/begin MEASUREMENT AION_request_fail_analysis_U.InBus_get_BCS_info_get_FLWheelSpdEdgesSumVD "" UBYTE AION_request_fail_analysis_CM_uint8 0 0 0 1 ECU_ADDRESS 0x00203128 /end MEASUREMENT
/begin MEASUREMENT AION_request_fail_analysis_U.InBus_get_BCS_info_get_FLWheelSpdVD "" UBYTE AION_request_fail_analysis_CM_uint8 0 0 0 1 ECU_ADDRESS 0x00203180 /end MEASUREMENT
/begin MEASUREMENT AION_request_fail_analysis_U.InBus_get_BCS_info_get_FRWheelRotatedDirection "" UBYTE AION_request_fail_analysis_CM_uint8 0 0 0 1 ECU_ADDRESS 0x00203181 /end MEASUREMENT
/begin MEASUREMENT AION_request_fail_analysis_U.InBus_get_BCS_info_get_FRWheelRotatedDirectionVD "" UBYTE AION_request_fail_analysis_CM_uint8 0 0 0 1 ECU_ADDRESS 0x00203182 /end MEASUREMENT
/begin MEASUREMENT AION_request_fail_analysis_U.InBus_get_BCS_info_get_FRWheelSpd "" FLOAT64_IEEE AION_request_fail_analysis_CM_double_km_h 0 0 0 240 ECU_ADDRESS 0x00203188 /end MEASUREMENT
/begin MEASUREMENT AION_request_fail_analysis_U.InBus_get_BCS_info_get_FRWheelSpdEdgesSum "" ULONG AION_request_fail_analysis_CM_uint32 0 0 0 4095 ECU_ADDRESS 0x0020312C /end MEASUREMENT
/begin MEASUREMENT AION_request_fail_analysis_U.InBus_get_BCS_info_get_FRWheelSpdEdgesSumVD "" UBYTE AION_request_fail_analysis_CM_uint8 0 0 0 1 ECU_ADDRESS 0x00203130 /end MEASUREMENT
/begin MEASUREMENT AION_request_fail_analysis_U.InBus_get_BCS_info_get_FRWheelSpdVD "" UBYTE AION_request_fail_analysis_CM_uint8 0 0 0 1 ECU_ADDRESS 0x00203190 /end MEASUREMENT
/begin MEASUREMENT AION_request_fail_analysis_U.InBus_get_BCS_info_get_HDCCtrlSt "" UBYTE AION_request_fail_analysis_CM_uint8__ 0 0 0 3 ECU_ADDRESS 0x00203159 /end MEASUREMENT
/begin MEASUREMENT AION_request_fail_analysis_U.InBus_get_BCS_info_get_HDCErrSt "" UBYTE AION_request_fail_analysis_CM_uint8__ 0 0 0 1 ECU_ADDRESS 0x0020315A /end MEASUREMENT
/begin MEASUREMENT AION_request_fail_analysis_U.InBus_get_BCS_info_get_MasterCylinderPr "" FLOAT64_IEEE AION_request_fail_analysis_CM_double_bar 0 0 0 250 ECU_ADDRESS 0x00203160 /end MEASUREMENT
/begin MEASUREMENT AION_request_fail_analysis_U.InBus_get_BCS_info_get_MasterCylinderPrOffset "" FLOAT64_IEEE AION_request_fail_analysis_CM_double_bar 0 0 -15 15 ECU_ADDRESS 0x00203168 /end MEASUREMENT
/begin MEASUREMENT AION_request_fail_analysis_U.InBus_get_BCS_info_get_MasterCylinderPrOffsetVD "" UBYTE AION_request_fail_analysis_CM_uint8__ 0 0 0 1 ECU_ADDRESS 0x00203170 /end MEASUREMENT
/begin MEASUREMENT AION_request_fail_analysis_U.InBus_get_BCS_info_get_MasterCylinderPrVD "" UBYTE AION_request_fail_analysis_CM_uint8__ 0 0 0 1 ECU_ADDRESS 0x00203171 /end MEASUREMENT
/begin MEASUREMENT AION_request_fail_analysis_U.InBus_get_BCS_info_get_NoBrakeForce "" UBYTE AION_request_fail_analysis_CM_uint8 0 0 0 1 ECU_ADDRESS 0x00203172 /end MEASUREMENT
/begin MEASUREMENT AION_request_fail_analysis_U.InBus_get_BCS_info_get_RLWheelRotatedDirection "" UBYTE AION_request_fail_analysis_CM_uint8 0 0 0 1 ECU_ADDRESS 0x00203191 /end MEASUREMENT
/begin MEASUREMENT AION_request_fail_analysis_U.InBus_get_BCS_info_get_RLWheelRotatedDirectionVD "" UBYTE AION_request_fail_analysis_CM_uint8 0 0 0 1 ECU_ADDRESS 0x00203192 /end MEASUREMENT
/begin MEASUREMENT AION_request_fail_analysis_U.InBus_get_BCS_info_get_RLWheelSpd "" FLOAT64_IEEE AION_request_fail_analysis_CM_double_km_h 0 0 0 240 ECU_ADDRESS 0x00203198 /end MEASUREMENT
/begin MEASUREMENT AION_request_fail_analysis_U.InBus_get_BCS_info_get_RLWheelSpdEdgesSum "" ULONG AION_request_fail_analysis_CM_uint32 0 0 0 4095 ECU_ADDRESS 0x00203134 /end MEASUREMENT
/begin MEASUREMENT AION_request_fail_analysis_U.InBus_get_BCS_info_get_RLWheelSpdEdgesSumVD "" UBYTE AION_request_fail_analysis_CM_uint8 0 0 0 1 ECU_ADDRESS 0x00203138 /end MEASUREMENT
/begin MEASUREMENT AION_request_fail_analysis_U.InBus_get_BCS_info_get_RLWheelSpdVD "" UBYTE AION_request_fail_analysis_CM_uint8 0 0 0 1 ECU_ADDRESS 0x002031A0 /end MEASUREMENT
/begin MEASUREMENT AION_request_fail_analysis_U.InBus_get_BCS_info_get_RRWheelRotatedDirection "" UBYTE AION_request_fail_analysis_CM_uint8 0 0 0 1 ECU_ADDRESS 0x002031A1 /end MEASUREMENT
/begin MEASUREMENT AION_request_fail_analysis_U.InBus_get_BCS_info_get_RRWheelRotatedDirectionVD "" UBYTE AION_request_fail_analysis_CM_uint8 0 0 0 1 ECU_ADDRESS 0x002031A2 /end MEASUREMENT
/begin MEASUREMENT AION_request_fail_analysis_U.InBus_get_BCS_info_get_RRWheelSpd "" FLOAT64_IEEE AION_request_fail_analysis_CM_double_km_h 0 0 0 240 ECU_ADDRESS 0x002031A8 /end MEASUREMENT
/begin MEASUREMENT AION_request_fail_analysis_U.InBus_get_BCS_info_get_RRWheelSpdEdgesSum "" ULONG AION_request_fail_analysis_CM_uint32 0 0 0 4095 ECU_ADDRESS 0x0020313C /end MEASUREMENT
/begin MEASUREMENT AION_request_fail_analysis_U.InBus_get_BCS_info_get_RRWheelSpdEdgesSumVD "" UBYTE AION_request_fail_analysis_CM_uint8 0 0 0 1 ECU_ADDRESS 0x00203140 /end MEASUREMENT
/begin MEASUREMENT AION_request_fail_analysis_U.InBus_get_BCS_info_get_RRWheelSpdVD "" UBYTE AION_request_fail_analysis_CM_uint8 0 0 0 1 ECU_ADDRESS 0x002031B0 /end MEASUREMENT
/begin MEASUREMENT AION_request_fail_analysis_U.InBus_get_BCS_info_get_VDCActiveSt "" UBYTE AION_request_fail_analysis_CM_uint8__ 0 0 0 1 ECU_ADDRESS 0x00203116 /end MEASUREMENT
/begin MEASUREMENT AION_request_fail_analysis_U.InBus_get_BCS_info_get_VDCFaultSt "" UBYTE AION_request_fail_analysis_CM_uint8__ 0 0 0 1 ECU_ADDRESS 0x00203117 /end MEASUREMENT
/begin MEASUREMENT AION_request_fail_analysis_U.InBus_get_BCS_info_get_VehLaltrlAccelOffset "" FLOAT64_IEEE AION_request_fail_analysis_CM_double_m_s_2 0 0 -21.593 21.593 ECU_ADDRESS 0x002031D8 /end MEASUREMENT
/begin MEASUREMENT AION_request_fail_analysis_U.InBus_get_BCS_info_get_VehLongAccelOffset "" FLOAT64_IEEE AION_request_fail_analysis_CM_double_m_s_2 0 0 -21.593 21.593 ECU_ADDRESS 0x002031E0 /end MEASUREMENT
/begin MEASUREMENT AION_request_fail_analysis_U.InBus_get_BCS_info_get_VehSpd "" FLOAT64_IEEE AION_request_fail_analysis_CM_double_km_h 0 0 0 240 ECU_ADDRESS 0x00203118 /end MEASUREMENT
/begin MEASUREMENT AION_request_fail_analysis_U.InBus_get_BCS_info_get_VehSpdVD "" UBYTE AION_request_fail_analysis_CM_uint8__ 0 0 0 1 ECU_ADDRESS 0x00203120 /end MEASUREMENT
/begin MEASUREMENT AION_request_fail_analysis_U.InBus_get_BCS_info_get_VehicleStandStillSt "" UBYTE AION_request_fail_analysis_CM_uint8 0 0 0 3 ECU_ADDRESS 0x00203173 /end MEASUREMENT
/begin MEASUREMENT AION_request_fail_analysis_U.InBus_get_BCS_info_get_YawRate "" FLOAT64_IEEE AION_request_fail_analysis_CM_double_rad_s 0 0 -2.0943 1.9047234375 ECU_ADDRESS 0x00203148 /end MEASUREMENT
/begin MEASUREMENT AION_request_fail_analysis_U.InBus_get_BCS_info_get_YawRateOffset "" FLOAT64_IEEE AION_request_fail_analysis_CM_double_rad_s 0 0 -0.13 0.13 ECU_ADDRESS 0x00203150 /end MEASUREMENT
/begin MEASUREMENT AION_request_fail_analysis_U.InBus_get_BCS_info_get_YawRateSt "" UBYTE AION_request_fail_analysis_CM_uint8 0 0 0 1 ECU_ADDRESS 0x00203158 /end MEASUREMENT
/begin MEASUREMENT AION_request_fail_analysis_U.InBus_get_EPB_info_get_FailSt "" SLONG AION_request_fail_analysis_CM_Error_status 0 0 0 1 ECU_ADDRESS 0x002032E4 /end MEASUREMENT
/begin MEASUREMENT AION_request_fail_analysis_U.InBus_get_EPB_info_get_SwitchSt "" UBYTE AION_request_fail_analysis_CM_uint8 0 0 0 3 ECU_ADDRESS 0x002032E8 /end MEASUREMENT
/begin MEASUREMENT AION_request_fail_analysis_U.InBus_get_EPB_info_get_SwitchStVD "" UBYTE AION_request_fail_analysis_CM_uint8 0 0 0 1 ECU_ADDRESS 0x002032E9 /end MEASUREMENT
/begin MEASUREMENT AION_request_fail_analysis_U.InBus_get_EPB_info_get_SysSt "" UBYTE AION_request_fail_analysis_CM_uint8 0 0 0 7 ECU_ADDRESS 0x002032EA /end MEASUREMENT
/begin MEASUREMENT AION_request_fail_analysis_U.InBus_get_EPS_info_get_SteeringAngle "" FLOAT64_IEEE AION_request_fail_analysis_CM_double_deg 0 0 -780 779.9 ECU_ADDRESS 0x002032F0 /end MEASUREMENT
/begin MEASUREMENT AION_request_fail_analysis_U.InBus_get_EPS_info_get_SteeringAngleSpd "" ULONG AION_request_fail_analysis_CM_uint32_deg_sec 0 0 0 1016 ECU_ADDRESS 0x002032F8 /end MEASUREMENT
/begin MEASUREMENT AION_request_fail_analysis_U.InBus_get_EPS_info_get_SteeringAngleSpdVD "" UBYTE AION_request_fail_analysis_CM_uint8 0 0 0 1 ECU_ADDRESS 0x002032FC /end MEASUREMENT
/begin MEASUREMENT AION_request_fail_analysis_U.InBus_get_EPS_info_get_SteeringAngleVD "" UBYTE AION_request_fail_analysis_CM_uint8 0 0 0 1 ECU_ADDRESS 0x002032FD /end MEASUREMENT
/begin MEASUREMENT AION_request_fail_analysis_U.InBus_get_EPS_info_get_StrngWhlTorq "" FLOAT64_IEEE AION_request_fail_analysis_CM_double_Nm 0 0 -12.5 12.5 ECU_ADDRESS 0x00203300 /end MEASUREMENT
/begin MEASUREMENT AION_request_fail_analysis_U.InBus_get_EPS_info_get_StrngWhlTorqVD "" UBYTE AION_request_fail_analysis_CM_uint8 0 0 0 1 ECU_ADDRESS 0x00203308 /end MEASUREMENT
/begin MEASUREMENT AION_request_fail_analysis_U.InBus_get_EPS_info_get_ThermalSt "" UBYTE AION_request_fail_analysis_CM_uint8 0 0 0 3 ECU_ADDRESS 0x00203309 /end MEASUREMENT
/begin MEASUREMENT AION_request_fail_analysis_U.InBus_get_EPS_info_get_WarnLamp "" UBYTE AION_request_fail_analysis_CM_uint8 0 0 0 1 ECU_ADDRESS 0x0020330A /end MEASUREMENT
/begin MEASUREMENT AION_request_fail_analysis_U.InBus_get_SCU_info_get_Checksum1 "" ULONG AION_request_fail_analysis_CM_uint32__ 0 0 0 255 ECU_ADDRESS 0x00203244 /end MEASUREMENT
/begin MEASUREMENT AION_request_fail_analysis_U.InBus_get_SCU_info_get_Checksum10 "" ULONG AION_request_fail_analysis_CM_uint32 0 0 0 255 ECU_ADDRESS 0x0020324C /end MEASUREMENT
/begin MEASUREMENT AION_request_fail_analysis_U.InBus_get_SCU_info_get_Checksum11 "" ULONG AION_request_fail_analysis_CM_uint32 0 0 0 255 ECU_ADDRESS 0x00203254 /end MEASUREMENT
/begin MEASUREMENT AION_request_fail_analysis_U.InBus_get_SCU_info_get_Checksum12 "" ULONG AION_request_fail_analysis_CM_uint32 0 0 0 255 ECU_ADDRESS 0x0020325C /end MEASUREMENT
/begin MEASUREMENT AION_request_fail_analysis_U.InBus_get_SCU_info_get_Checksum13 "" ULONG AION_request_fail_analysis_CM_uint32 0 0 0 255 ECU_ADDRESS 0x00203264 /end MEASUREMENT
/begin MEASUREMENT AION_request_fail_analysis_U.InBus_get_SCU_info_get_Checksum16 "" ULONG AION_request_fail_analysis_CM_uint32__ 0 0 0 205 ECU_ADDRESS 0x0020328C /end MEASUREMENT
/begin MEASUREMENT AION_request_fail_analysis_U.InBus_get_SCU_info_get_Checksum17 "" ULONG AION_request_fail_analysis_CM_uint32__ 0 0 0 255 ECU_ADDRESS 0x00203294 /end MEASUREMENT
/begin MEASUREMENT AION_request_fail_analysis_U.InBus_get_SCU_info_get_Checksum18 "" ULONG AION_request_fail_analysis_CM_uint32__ 0 0 0 255 ECU_ADDRESS 0x0020329C /end MEASUREMENT
/begin MEASUREMENT AION_request_fail_analysis_U.InBus_get_SCU_info_get_Checksum2 "" ULONG AION_request_fail_analysis_CM_uint32 0 0 0 255 ECU_ADDRESS 0x002032A4 /end MEASUREMENT
/begin MEASUREMENT AION_request_fail_analysis_U.InBus_get_SCU_info_get_Checksum3 "" ULONG AION_request_fail_analysis_CM_uint32 0 0 0 255 ECU_ADDRESS 0x002032AC /end MEASUREMENT
/begin MEASUREMENT AION_request_fail_analysis_U.InBus_get_SCU_info_get_Checksum4 "" ULONG AION_request_fail_analysis_CM_uint32__ 0 0 0 255 ECU_ADDRESS 0x002032B4 /end MEASUREMENT
/begin MEASUREMENT AION_request_fail_analysis_U.InBus_get_SCU_info_get_Checksum5 "" ULONG AION_request_fail_analysis_CM_uint32__ 0 0 0 255 ECU_ADDRESS 0x002032BC /end MEASUREMENT
/begin MEASUREMENT AION_request_fail_analysis_U.InBus_get_SCU_info_get_Checksum6 "" ULONG AION_request_fail_analysis_CM_uint32 0 0 0 255 ECU_ADDRESS 0x002032C4 /end MEASUREMENT
/begin MEASUREMENT AION_request_fail_analysis_U.InBus_get_SCU_info_get_Checksum7 "" ULONG AION_request_fail_analysis_CM_uint32 0 0 0 255 ECU_ADDRESS 0x002032CC /end MEASUREMENT
/begin MEASUREMENT AION_request_fail_analysis_U.InBus_get_SCU_info_get_Checksum8 "" ULONG AION_request_fail_analysis_CM_uint32 0 0 0 255 ECU_ADDRESS 0x002032D4 /end MEASUREMENT
/begin MEASUREMENT AION_request_fail_analysis_U.InBus_get_SCU_info_get_Checksum9 "" ULONG AION_request_fail_analysis_CM_uint32 0 0 0 255 ECU_ADDRESS 0x002032DC /end MEASUREMENT
/begin MEASUREMENT AION_request_fail_analysis_U.InBus_get_SCU_info_get_EStopSwSt "" UBYTE AION_request_fail_analysis_CM_uint8 0 0 0 1 ECU_ADDRESS 0x0020326C /end MEASUREMENT
/begin MEASUREMENT AION_request_fail_analysis_U.InBus_get_SCU_info_get_EStopSwStVD "" UBYTE AION_request_fail_analysis_CM_uint8 0 0 0 1 ECU_ADDRESS 0x0020326D /end MEASUREMENT
/begin MEASUREMENT AION_request_fail_analysis_U.InBus_get_SCU_info_get_LatAutoCheckReport "" ULONG AION_request_fail_analysis_CM_uint32 0 0 0 15 ECU_ADDRESS 0x00203270 /end MEASUREMENT
/begin MEASUREMENT AION_request_fail_analysis_U.InBus_get_SCU_info_get_LatCtrlMode "" SLONG AION_request_fail_analysis_CM_Control_status 0 0 0 3 ECU_ADDRESS 0x00203274 /end MEASUREMENT
/begin MEASUREMENT AION_request_fail_analysis_U.InBus_get_SCU_info_get_LatQuitReport "" ULONG AION_request_fail_analysis_CM_uint32 0 0 0 255 ECU_ADDRESS 0x00203278 /end MEASUREMENT
/begin MEASUREMENT AION_request_fail_analysis_U.InBus_get_SCU_info_get_LngAutoCheckIReport "" ULONG AION_request_fail_analysis_CM_uint32 0 0 0 65535 ECU_ADDRESS 0x0020327C /end MEASUREMENT
/begin MEASUREMENT AION_request_fail_analysis_U.InBus_get_SCU_info_get_LngCtrlMode "" SLONG AION_request_fail_analysis_CM_Control_status 0 0 0 3 ECU_ADDRESS 0x00203280 /end MEASUREMENT
/begin MEASUREMENT AION_request_fail_analysis_U.InBus_get_SCU_info_get_LngQuitReport "" ULONG AION_request_fail_analysis_CM_uint32 0 0 0 65535 ECU_ADDRESS 0x00203284 /end MEASUREMENT
/begin MEASUREMENT AION_request_fail_analysis_U.InBus_get_SCU_info_get_MsgCounter1 "" ULONG AION_request_fail_analysis_CM_uint32__ 0 0 0 15 ECU_ADDRESS 0x00203248 /end MEASUREMENT
/begin MEASUREMENT AION_request_fail_analysis_U.InBus_get_SCU_info_get_MsgCounter10 "" ULONG AION_request_fail_analysis_CM_uint32 0 0 0 15 ECU_ADDRESS 0x00203250 /end MEASUREMENT
/begin MEASUREMENT AION_request_fail_analysis_U.InBus_get_SCU_info_get_MsgCounter11 "" ULONG AION_request_fail_analysis_CM_uint32 0 0 0 15 ECU_ADDRESS 0x00203258 /end MEASUREMENT
/begin MEASUREMENT AION_request_fail_analysis_U.InBus_get_SCU_info_get_MsgCounter12 "" ULONG AION_request_fail_analysis_CM_uint32 0 0 0 15 ECU_ADDRESS 0x00203260 /end MEASUREMENT
/begin MEASUREMENT AION_request_fail_analysis_U.InBus_get_SCU_info_get_MsgCounter13 "" ULONG AION_request_fail_analysis_CM_uint32 0 0 0 15 ECU_ADDRESS 0x00203268 /end MEASUREMENT
/begin MEASUREMENT AION_request_fail_analysis_U.InBus_get_SCU_info_get_MsgCounter16 "" ULONG AION_request_fail_analysis_CM_uint32__ 0 0 0 15 ECU_ADDRESS 0x00203290 /end MEASUREMENT
/begin MEASUREMENT AION_request_fail_analysis_U.InBus_get_SCU_info_get_MsgCounter17 "" ULONG AION_request_fail_analysis_CM_uint32__ 0 0 0 15 ECU_ADDRESS 0x00203298 /end MEASUREMENT
/begin MEASUREMENT AION_request_fail_analysis_U.InBus_get_SCU_info_get_MsgCounter18 "" ULONG AION_request_fail_analysis_CM_uint32__ 0 0 0 15 ECU_ADDRESS 0x002032A0 /end MEASUREMENT
/begin MEASUREMENT AION_request_fail_analysis_U.InBus_get_SCU_info_get_MsgCounter2 "" ULONG AION_request_fail_analysis_CM_uint32 0 0 0 15 ECU_ADDRESS 0x002032A8 /end MEASUREMENT
/begin MEASUREMENT AION_request_fail_analysis_U.InBus_get_SCU_info_get_MsgCounter3 "" ULONG AION_request_fail_analysis_CM_uint32 0 0 0 15 ECU_ADDRESS 0x002032B0 /end MEASUREMENT
/begin MEASUREMENT AION_request_fail_analysis_U.InBus_get_SCU_info_get_MsgCounter4 "" ULONG AION_request_fail_analysis_CM_uint32__ 0 0 0 15 ECU_ADDRESS 0x002032B8 /end MEASUREMENT
/begin MEASUREMENT AION_request_fail_analysis_U.InBus_get_SCU_info_get_MsgCounter5 "" ULONG AION_request_fail_analysis_CM_uint32 0 0 0 15 ECU_ADDRESS 0x002032C0 /end MEASUREMENT
/begin MEASUREMENT AION_request_fail_analysis_U.InBus_get_SCU_info_get_MsgCounter6 "" ULONG AION_request_fail_analysis_CM_uint32 0 0 0 15 ECU_ADDRESS 0x002032C8 /end MEASUREMENT
/begin MEASUREMENT AION_request_fail_analysis_U.InBus_get_SCU_info_get_MsgCounter7 "" ULONG AION_request_fail_analysis_CM_uint32 0 0 0 15 ECU_ADDRESS 0x002032D0 /end MEASUREMENT
/begin MEASUREMENT AION_request_fail_analysis_U.InBus_get_SCU_info_get_MsgCounter8 "" ULONG AION_request_fail_analysis_CM_uint32 0 0 0 15 ECU_ADDRESS 0x002032D8 /end MEASUREMENT
/begin MEASUREMENT AION_request_fail_analysis_U.InBus_get_SCU_info_get_MsgCounter9 "" ULONG AION_request_fail_analysis_CM_uint32 0 0 0 15 ECU_ADDRESS 0x002032E0 /end MEASUREMENT
/begin MEASUREMENT AION_request_fail_analysis_U.InBus_get_SCU_info_get_StrngWhlIntv "" UBYTE AION_request_fail_analysis_CM_uint8 0 0 0 1 ECU_ADDRESS 0x00203288 /end MEASUREMENT
/begin MEASUREMENT AION_request_fail_analysis_U.InBus_get_SRS_info_get_DriverSeatBeltSt "" UBYTE AION_request_fail_analysis_CM_uint8 0 0 0 3 ECU_ADDRESS 0x002032EB /end MEASUREMENT
/begin MEASUREMENT AION_request_fail_analysis_U.InBus_get_SRS_info_get_PsngrSeatBeltSt "" UBYTE AION_request_fail_analysis_CM_uint8 0 0 0 3 ECU_ADDRESS 0x002032EC /end MEASUREMENT
/begin MEASUREMENT AION_request_fail_analysis_U.InBus_get_VCU_info_get_ACCButtInfo "" ULONG AION_request_fail_analysis_CM_uint32 0 0 0 255 ECU_ADDRESS 0x00203214 /end MEASUREMENT
/begin MEASUREMENT AION_request_fail_analysis_U.InBus_get_VCU_info_get_ACCMaxRecpDecel "" FLOAT64_IEEE AION_request_fail_analysis_CM_double_m_s2 0 0 -5 7.75 ECU_ADDRESS 0x00203200 /end MEASUREMENT
/begin MEASUREMENT AION_request_fail_analysis_U.InBus_get_VCU_info_get_ACCMaxRecpDecelVD "" UBYTE AION_request_fail_analysis_CM_uint8 0 0 0 1 ECU_ADDRESS 0x00203208 /end MEASUREMENT
/begin MEASUREMENT AION_request_fail_analysis_U.InBus_get_VCU_info_get_AccElecECFail "" UBYTE AION_request_fail_analysis_CM_uint8__ 0 0 0 1 ECU_ADDRESS 0x00203218 /end MEASUREMENT
/begin MEASUREMENT AION_request_fail_analysis_U.InBus_get_VCU_info_get_ActRecpTorq "" ULONG AION_request_fail_analysis_CM_uint32_Nm 0 0 0 2000 ECU_ADDRESS 0x002031F4 /end MEASUREMENT
/begin MEASUREMENT AION_request_fail_analysis_U.InBus_get_VCU_info_get_ActRecpTorqSt "" UBYTE AION_request_fail_analysis_CM_uint8 0 0 0 3 ECU_ADDRESS 0x002031F8 /end MEASUREMENT
/begin MEASUREMENT AION_request_fail_analysis_U.InBus_get_VCU_info_get_ActVehWheelTorq "" ULONG AION_request_fail_analysis_CM_uint32_Nm 0 0 0 10000 ECU_ADDRESS 0x0020320C /end MEASUREMENT
/begin MEASUREMENT AION_request_fail_analysis_U.InBus_get_VCU_info_get_BrkPedalSt "" UBYTE AION_request_fail_analysis_CM_uint8 0 0 0 1 ECU_ADDRESS 0x00203230 /end MEASUREMENT
/begin MEASUREMENT AION_request_fail_analysis_U.InBus_get_VCU_info_get_BrkPedalStVD "" UBYTE AION_request_fail_analysis_CM_uint8 0 0 0 1 ECU_ADDRESS 0x00203231 /end MEASUREMENT
/begin MEASUREMENT AION_request_fail_analysis_U.InBus_get_VCU_info_get_CrntGearLvl "" UBYTE AION_request_fail_analysis_CM_uint8 0 0 0 7 ECU_ADDRESS 0x002031F9 /end MEASUREMENT
/begin MEASUREMENT AION_request_fail_analysis_U.InBus_get_VCU_info_get_CrntGearLvlVD "" UBYTE AION_request_fail_analysis_CM_uint8 0 0 0 1 ECU_ADDRESS 0x002031FA /end MEASUREMENT
/begin MEASUREMENT AION_request_fail_analysis_U.InBus_get_VCU_info_get_GasPedalActPst "" FLOAT64_IEEE AION_request_fail_analysis_CM_double__ 0 0 0 99.96 ECU_ADDRESS 0x00203220 /end MEASUREMENT
/begin MEASUREMENT AION_request_fail_analysis_U.InBus_get_VCU_info_get_GasPedalActPstVD "" UBYTE AION_request_fail_analysis_CM_uint8 0 0 0 1 ECU_ADDRESS 0x00203228 /end MEASUREMENT
/begin MEASUREMENT AION_request_fail_analysis_U.InBus_get_VCU_info_get_GasPedalVirtualPst "" FLOAT64_IEEE AION_request_fail_analysis_CM_double__ 0 0 0 99.96 ECU_ADDRESS 0x00203238 /end MEASUREMENT
/begin MEASUREMENT AION_request_fail_analysis_U.InBus_get_VCU_info_get_GasPedalVirtualPstVD "" UBYTE AION_request_fail_analysis_CM_uint8 0 0 0 1 ECU_ADDRESS 0x00203240 /end MEASUREMENT
/begin MEASUREMENT AION_request_fail_analysis_U.InBus_get_VCU_info_get_GearLeverIntv "" UBYTE AION_request_fail_analysis_CM_uint8 0 0 0 1 ECU_ADDRESS 0x002031E8 /end MEASUREMENT
/begin MEASUREMENT AION_request_fail_analysis_U.InBus_get_VCU_info_get_LateralAssistBtnInfo "" UBYTE AION_request_fail_analysis_CM_uint8 0 0 0 1 ECU_ADDRESS 0x00203210 /end MEASUREMENT
/begin MEASUREMENT AION_request_fail_analysis_U.InBus_get_VCU_info_get_LateralAssistBtnInfoVD "" UBYTE AION_request_fail_analysis_CM_uint8 0 0 0 1 ECU_ADDRESS 0x00203211 /end MEASUREMENT
/begin MEASUREMENT AION_request_fail_analysis_U.InBus_get_VCU_info_get_VehDrvMod "" UBYTE AION_request_fail_analysis_CM_uint8__ 0 0 0 7 ECU_ADDRESS 0x002031E9 /end MEASUREMENT
/begin MEASUREMENT AION_request_fail_analysis_U.InBus_get_VCU_info_get_VehRdySt "" SLONG AION_request_fail_analysis_CM_Ready_status__ 0 0 0 1 ECU_ADDRESS 0x002031EC /end MEASUREMENT
/begin MEASUREMENT AION_request_fail_analysis_U.InBus_get_VCU_info_get_VehRng "" ULONG AION_request_fail_analysis_CM_uint32_km 0 0 0 1000 ECU_ADDRESS 0x002031F0 /end MEASUREMENT
/begin MEASUREMENT AION_request_fail_analysis_U.InBus_get_VCU_info_get_VehWheelTorqMax "" ULONG AION_request_fail_analysis_CM_uint32_Nm 0 0 0 10000 ECU_ADDRESS 0x0020322C /end MEASUREMENT
/begin MEASUREMENT AION_request_fail_analysis_U.InBus_set_ADCU_info_set_BeamReq "" UBYTE AION_request_fail_analysis_CM_uint8__ 0 0 0 3 ECU_ADDRESS 0x00203110 /end MEASUREMENT
/begin MEASUREMENT AION_request_fail_analysis_U.InBus_set_ADCU_info_set_BodyCtrlReq "" UBYTE AION_request_fail_analysis_CM_uint8__ 0 0 0 1 ECU_ADDRESS 0x00203111 /end MEASUREMENT
/begin MEASUREMENT AION_request_fail_analysis_U.InBus_set_ADCU_info_set_Checksum1 "" ULONG AION_request_fail_analysis_CM_uint32 0 0 0 255 ECU_ADDRESS 0x002030F8 /end MEASUREMENT
/begin MEASUREMENT AION_request_fail_analysis_U.InBus_set_ADCU_info_set_Checksum2 "" ULONG AION_request_fail_analysis_CM_uint32 0 0 0 255 ECU_ADDRESS 0x00203100 /end MEASUREMENT
/begin MEASUREMENT AION_request_fail_analysis_U.InBus_set_ADCU_info_set_Checksum3 "" ULONG AION_request_fail_analysis_CM_uint32__ 0 0 0 255 ECU_ADDRESS 0x00203108 /end MEASUREMENT
/begin MEASUREMENT AION_request_fail_analysis_U.InBus_set_ADCU_info_set_HornRingReq "" UBYTE AION_request_fail_analysis_CM_uint8__ 0 0 0 1 ECU_ADDRESS 0x00203112 /end MEASUREMENT
/begin MEASUREMENT AION_request_fail_analysis_U.InBus_set_ADCU_info_set_MsgCounter1 "" ULONG AION_request_fail_analysis_CM_uint32 0 0 0 15 ECU_ADDRESS 0x002030FC /end MEASUREMENT
/begin MEASUREMENT AION_request_fail_analysis_U.InBus_set_ADCU_info_set_MsgCounter2 "" ULONG AION_request_fail_analysis_CM_uint32 0 0 0 15 ECU_ADDRESS 0x00203104 /end MEASUREMENT
/begin MEASUREMENT AION_request_fail_analysis_U.InBus_set_ADCU_info_set_MsgCounter3 "" ULONG AION_request_fail_analysis_CM_uint32__ 0 0 0 15 ECU_ADDRESS 0x0020310C /end MEASUREMENT
/begin MEASUREMENT AION_request_fail_analysis_U.InBus_set_ADCU_info_set_TurnLightReq "" UBYTE AION_request_fail_analysis_CM_uint8__ 0 0 0 3 ECU_ADDRESS 0x00203113 /end MEASUREMENT
/begin MEASUREMENT AION_request_fail_analysis_U.InBus_set_lateral_control_info_set_LatCtrlReq "" SLONG AION_request_fail_analysis_CM_Control_request 0 0 0 3 ECU_ADDRESS 0x002030C0 /end MEASUREMENT
/begin MEASUREMENT AION_request_fail_analysis_U.InBus_set_lateral_control_info_set_SteerAngReq "" FLOAT64_IEEE AION_request_fail_analysis_CM_double 0 0 -1.7E+308 1.7E+308 ECU_ADDRESS 0x002030D0 /end MEASUREMENT
/begin MEASUREMENT AION_request_fail_analysis_U.InBus_set_lateral_control_info_set_SteerAngSpdLimt "" FLOAT64_IEEE AION_request_fail_analysis_CM_double 0 0 -1.7E+308 1.7E+308 ECU_ADDRESS 0x002030D8 /end MEASUREMENT
/begin MEASUREMENT AION_request_fail_analysis_U.InBus_set_lateral_control_info_set_SteerWhlTorqReq "" FLOAT64_IEEE AION_request_fail_analysis_CM_double 0 0 -1.7E+308 1.7E+308 ECU_ADDRESS 0x002030C8 /end MEASUREMENT
/begin MEASUREMENT AION_request_fail_analysis_U.InBus_set_longitudinal_control_info_set_AutoTrqWhlReq "" SLONG AION_request_fail_analysis_CM_int32 0 0 0 [] ECU_ADDRESS 0x002030E4 /end MEASUREMENT
/begin MEASUREMENT AION_request_fail_analysis_U.InBus_set_longitudinal_control_info_set_BrakeReq "" FLOAT64_IEEE AION_request_fail_analysis_CM_double 0 0 0 [] ECU_ADDRESS 0x002030E8 /end MEASUREMENT
/begin MEASUREMENT AION_request_fail_analysis_U.InBus_set_longitudinal_control_info_set_GearLvlReq "" SLONG AION_request_fail_analysis_CM_AION_gear 0 0 0 7 ECU_ADDRESS 0x002030F0 /end MEASUREMENT
/begin MEASUREMENT AION_request_fail_analysis_U.InBus_set_longitudinal_control_info_set_GearLvlReqVD "" SLONG AION_request_fail_analysis_CM_Validation_status 0 0 0 1 ECU_ADDRESS 0x002030F4 /end MEASUREMENT
/begin MEASUREMENT AION_request_fail_analysis_U.InBus_set_longitudinal_control_info_set_LngCtrlReq "" SLONG AION_request_fail_analysis_CM_Control_request 0 0 0 3 ECU_ADDRESS 0x002030E0 /end MEASUREMENT
/begin COMPU_METHOD AION_request_fail_analysis_CM_AION_gear "" TAB_VERB "%0.6" "" COMPU_TAB_REF VTAB_FOR_AION_request_fail_analysis_CM_AION_gear /end COMPU_METHOD
/begin COMPU_VTAB VTAB_FOR_AION_request_fail_analysis_CM_AION_gear "Enumerated data type: AION_gear" TAB_VERB 8 0 "NoRequest" 1 "P" 2 "R" 3 "N" 4 "D" 5 "Reserved_gear" 6 "Reserved1_gear" 7 "Reserved2_gear" /end COMPU_VTAB
/begin COMPU_METHOD AION_request_fail_analysis_CM_Available_status "" TAB_VERB "%0.6" "" COMPU_TAB_REF VTAB_FOR_AION_request_fail_analysis_CM_Available_status /end COMPU_METHOD
/begin COMPU_VTAB VTAB_FOR_AION_request_fail_analysis_CM_Available_status "Enumerated data type: Available_status" TAB_VERB 2 0 "NotAvailable" 1 "Available" /end COMPU_VTAB
/begin COMPU_METHOD AION_request_fail_analysis_CM_Control_request "" TAB_VERB "%0.6" "" COMPU_TAB_REF VTAB_FOR_AION_request_fail_analysis_CM_Control_request /end COMPU_METHOD
/begin COMPU_VTAB VTAB_FOR_AION_request_fail_analysis_CM_Control_request "Enumerated data type: Control_request" TAB_VERB 4 0 "Manual" 1 "Auto" 2 "Reserved" 3 "Reserved1" /end COMPU_VTAB
/begin COMPU_METHOD AION_request_fail_analysis_CM_Control_status "" TAB_VERB "%0.6" "" COMPU_TAB_REF VTAB_FOR_AION_request_fail_analysis_CM_Control_status /end COMPU_METHOD
/begin COMPU_VTAB VTAB_FOR_AION_request_fail_analysis_CM_Control_status "Enumerated data type: Control_status" TAB_VERB 4 0 "ManualStatus" 1 "QuitStatus" 2 "AutoStatus" 3 "FaultStatus" /end COMPU_VTAB
/begin COMPU_METHOD AION_request_fail_analysis_CM_Error_status "" TAB_VERB "%0.6" "" COMPU_TAB_REF VTAB_FOR_AION_request_fail_analysis_CM_Error_status /end COMPU_METHOD
/begin COMPU_VTAB VTAB_FOR_AION_request_fail_analysis_CM_Error_status "Enumerated data type: Error_status" TAB_VERB 2 0 "NoError" 1 "Error" /end COMPU_VTAB
/begin COMPU_METHOD AION_request_fail_analysis_CM_Ready_status__ "" TAB_VERB "%0.6" "-" COMPU_TAB_REF VTAB_FOR_AION_request_fail_analysis_CM_Ready_status__ /end COMPU_METHOD
/begin COMPU_VTAB VTAB_FOR_AION_request_fail_analysis_CM_Ready_status__ "Enumerated data type: Ready_status" TAB_VERB 2 0 "NotReady" 1 "Ready" /end COMPU_VTAB
/begin COMPU_METHOD AION_request_fail_analysis_CM_Validation_status "" TAB_VERB "%0.6" "" COMPU_TAB_REF VTAB_FOR_AION_request_fail_analysis_CM_Validation_status /end COMPU_METHOD
/begin COMPU_VTAB VTAB_FOR_AION_request_fail_analysis_CM_Validation_status "Enumerated data type: Validation_status" TAB_VERB 2 0 "Invalid" 1 "Valid" /end COMPU_VTAB
/begin COMPU_METHOD AION_request_fail_analysis_CM_double "" IDENTICAL "%15.10" "" /end COMPU_METHOD
/begin COMPU_METHOD AION_request_fail_analysis_CM_double_Nm "" IDENTICAL "%15.10" "Nm" /end COMPU_METHOD
/begin COMPU_METHOD AION_request_fail_analysis_CM_double__ "" IDENTICAL "%15.10" "%" /end COMPU_METHOD
/begin COMPU_METHOD AION_request_fail_analysis_CM_double_bar "" IDENTICAL "%15.10" "bar" /end COMPU_METHOD
/begin COMPU_METHOD AION_request_fail_analysis_CM_double_deg "" IDENTICAL "%15.10" "deg" /end COMPU_METHOD
/begin COMPU_METHOD AION_request_fail_analysis_CM_double_km_h "" IDENTICAL "%15.10" "km/h" /end COMPU_METHOD
/begin COMPU_METHOD AION_request_fail_analysis_CM_double_m_s2 "" IDENTICAL "%15.10" "m/s2" /end COMPU_METHOD
/begin COMPU_METHOD AION_request_fail_analysis_CM_double_m_s_2 "" IDENTICAL "%15.10" "m/s^2" /end COMPU_METHOD
/begin COMPU_METHOD AION_request_fail_analysis_CM_double_rad_s "" IDENTICAL "%15.10" "rad/s" /end COMPU_METHOD
/begin COMPU_METHOD AION_request_fail_analysis_CM_int32 "" IDENTICAL "%10.0" "" /end COMPU_METHOD
/begin COMPU_METHOD AION_request_fail_analysis_CM_uint32 "" IDENTICAL "%10.0" "" /end COMPU_METHOD
/begin COMPU_METHOD AION_request_fail_analysis_CM_uint32_Nm "" IDENTICAL "%10.0" "Nm" /end COMPU_METHOD
/begin COMPU_METHOD AION_request_fail_analysis_CM_uint32__ "" IDENTICAL "%10.0" "-" /end COMPU_METHOD
/begin COMPU_METHOD AION_request_fail_analysis_CM_uint32_deg_sec "" IDENTICAL "%10.0" "deg/sec" /end COMPU_METHOD
/begin COMPU_METHOD AION_request_fail_analysis_CM_uint32_km "" IDENTICAL "%10.0" "km" /end COMPU_METHOD
/begin COMPU_METHOD AION_request_fail_analysis_CM_uint8 "" IDENTICAL "%3.0" "" /end COMPU_METHOD
/begin COMPU_METHOD AION_request_fail_analysis_CM_uint8__ "" IDENTICAL "%3.0" "-" /end COMPU_METHOD
/begin RECORD_LAYOUT Scalar_FLOAT64_IEEE FNC_VALUES 1 FLOAT64_IEEE COLUMN_DIR DIRECT /end RECORD_LAYOUT
/begin RECORD_LAYOUT Scalar_SLONG FNC_VALUES 1 SLONG COLUMN_DIR DIRECT /end RECORD_LAYOUT
/begin RECORD_LAYOUT Scalar_UBYTE FNC_VALUES 1 UBYTE COLUMN_DIR DIRECT /end RECORD_LAYOUT
/begin RECORD_LAYOUT Scalar_ULONG FNC_VALUES 1 ULONG COLUMN_DIR DIRECT /end RECORD_LAYOUT
/begin GROUP AION_request_fail_analysis "AION_request_fail_analysis" ROOT /end GROUP
/end MODULE
/end PROJECT
